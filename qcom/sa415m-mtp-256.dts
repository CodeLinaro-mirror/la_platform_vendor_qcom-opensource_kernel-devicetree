// SPDX-License-Identifier: BSD-3-Clause
/*
 * Copyright (c) Qualcomm Technologies, Inc. and/or its subsidiaries.
 */

/dts-v1/;

#include "sa415m-mtp-256.dtsi"

/ {
	model = "Qualcomm Technologies, Inc. SA415M MTP (256MB)";
	compatible = "qcom,sa415m-ccard",
			"qcom,sa415m", "qcom,ccard";
	qcom,board-id = <8 0x106>;
};

