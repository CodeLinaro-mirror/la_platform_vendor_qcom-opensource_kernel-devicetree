// SPDX-License-Identifier: BSD-3-Clause
/*
 * Copyright (c) Qualcomm Technologies, Inc. and/or its subsidiaries.
 */

/dts-v1/;

#include "katmaip.dtsi"

/ {
	model = "Qualcomm Technologies, Inc. KATMAIP SoC";
	compatible = "qcom,yupikp-iot";
	qcom,board-id = <0 0>;
};
