// SPDX-License-Identifier: BSD-3-Clause
/*
 * Copyright (c) Qualcomm Technologies, Inc. and/or its subsidiaries.
 */

#include "yupikp-idp.dtsi"
#include "qcx6490-cnss.dtsi"

&pcie0 {
	status = "ok";
};

&pcie0_msi {
	status = "ok";
};
