// SPDX-License-Identifier: BSD-3-Clause
/*
 * Copyright (c) Qualcomm Technologies, Inc. and/or its subsidiaries.
 */

/dts-v1/;

#include "sdxbaagha.dtsi"
#include "sdxbaagha-qmp.dtsi"
#include "sdxbaagha-qmp-rome.dtsi"

/ {
	model = "Qualcomm Technologies, Inc. SDXBAAGHA QMP 256M ROME";
	compatible = "qcom,sdxbaagha-qmp",
		"qcom,sdxbaagha", "qcom,qmp";
	qcom,board-id = <0x10022 0x101>, <0x10022 0x201>;
};
