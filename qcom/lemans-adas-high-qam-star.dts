// SPDX-License-Identifier: BSD-3-Clause
/*
 * Copyright (c) Qualcomm Technologies, Inc. and/or its subsidiaries.
 */

/dts-v1/;

#include "lemans-adas-high.dtsi"
#include "lemans-qam-star.dtsi"

/ {
	model = "Qualcomm Technologies, Inc. Lemans ADAS HIGH QAM STAR";
	compatible = "qcom,lemans-adas-high", "qcom,lemans", "qcom,qam-star", "qcom,lemans-adas-high-qam-star";
};

