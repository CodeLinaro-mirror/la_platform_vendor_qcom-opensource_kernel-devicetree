// SPDX-License-Identifier: BSD-3-Clause
/*
 * Copyright (c) Qualcomm Technologies, Inc. and/or its subsidiaries.
 */

/dts-v1/;

#include "kona-v2.dtsi"
#include "kona-qrd.dtsi"

/ {
	model = "Qualcomm Technologies, Inc. kona QRD";
	compatible = "qcom,kona-qrd", "qcom,kona", "qcom,qrd";
	qcom,board-id = <11 0>;
};
