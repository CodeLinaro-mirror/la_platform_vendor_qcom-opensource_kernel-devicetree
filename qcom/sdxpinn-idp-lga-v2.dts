// SPDX-License-Identifier: BSD-3-Clause
/*
 * Copyright (c) Qualcomm Technologies, Inc. and/or its subsidiaries.
 */

/dts-v1/;

#include "sdxpinn.dtsi"
#include "sdxpinn-idp-lga-v2.dtsi"
#include "sdxpinn-reserved-memory-2G.dtsi"

/ {
	model = "Qualcomm Technologies, Inc. SDXPINN IDP LGA V2";
	compatible = "qcom,sdxpinn-idp",
			"qcom,sdxpinn", "qcom,idp";
	qcom,board-id = <0x5020022 0x305>, <0x5020022 0x405>;
};
