/dts-v1/;
/plugin/;

#include "sa525m-idp.dtsi"
#include "sa525m-dsmharq-41m.dtsi"

/ {
	model = "Qualcomm Technologies, Inc. SA525 NAND IDP V3 Overlay";
	compatible = "qcom,sdxpinn-idp",
		"qcom,sdxpinn", "qcom,idp";
	qcom,msm-id=<558 0x10000>;
	qcom,board-id = <0x0030022 0x20000>;
};
