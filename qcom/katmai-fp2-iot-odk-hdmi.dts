/dts-v1/;

#include "katmai-fp2-iot-odk-hdmi.dtsi"

/ {
	model = "Qualcomm Technologies, Inc. Katmai FP2 IoT Open Dev Kit + HDMI";
	compatible = "qcom,yupik-iot-idp", "qcom,yupik-iot", "qcom,idp";
	qcom,msm-id = <575 0x10000>, <576 0x10000>;
	qcom,board-id = <0x010020 0>;
	qcom,softsku-id = <2>;
};
