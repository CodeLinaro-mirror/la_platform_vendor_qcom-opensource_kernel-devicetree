// SPDX-License-Identifier: BSD-3-Clause
/*
 * Copyright (c) Qualcomm Technologies, Inc. and/or its subsidiaries.
 */

#include "lemans.dtsi"

/ {
	model = "Qualcomm Technologies, Inc. LeMans IVI SoC";
	compatible = "qcom,lemans", "qcom,lemans-ivi";
	qcom,msm-id = <532 0x10000>;
};
