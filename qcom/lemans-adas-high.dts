// SPDX-License-Identifier: BSD-3-Clause
/*
 * Copyright (c) Qualcomm Technologies, Inc. and/or its subsidiaries.
 */

/dts-v1/;

#include "lemans-adas-high.dtsi"

/ {
	model = "Qualcomm Technologies, Inc. Lemans ADAS HIGH SoC";
	compatible = "qcom,lemans", "qcom,lemans-adas-high";
	qcom,board-id = <0 0>;
};
