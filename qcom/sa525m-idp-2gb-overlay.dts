/dts-v1/;
/plugin/;

#include "sa525m-idp.dtsi"
#include "sa525m-reserved-memory-2G.dtsi"

/ {
	model = "Qualcomm Technologies, Inc. SA525 IDP 2GB Overlay";
	compatible = "qcom,sdxpinn-idp",
		"qcom,sdxpinn", "qcom,idp";
	qcom,msm-id=<558 0x10000>;
	qcom,board-id = <0x0010022 0x400>;
};
