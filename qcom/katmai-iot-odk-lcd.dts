// SPDX-License-Identifier: BSD-3-Clause
/*
 * Copyright (c) Qualcomm Technologies, Inc. and/or its subsidiaries.
 */

/dts-v1/;

#include "katmai-iot-odk-lcd.dtsi"

/ {
	model = "Qualcomm Technologies, Inc. Katmai IoT Open Dev Kit + LCD";
	compatible = "qcom,yupik-iot-idp", "qcom,yupik-iot", "qcom,idp";
	qcom,msm-id = <575 0x10000>, <576 0x10000>;
	qcom,board-id = <0x010120 0>;
	qcom,softsku-id = <1>;
};
