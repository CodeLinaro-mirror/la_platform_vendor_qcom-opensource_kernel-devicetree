// SPDX-License-Identifier: BSD-3-Clause
/*
 * Copyright (c) Qualcomm Technologies, Inc. and/or its subsidiaries.
 */

#include "kalama-v2.dtsi"

/ {
	model = "Qualcomm Technologies, Inc. Kalama SG";
	compatible = "qcom,kalama";
	qcom,msm-id = <600 0x20000>;
};
