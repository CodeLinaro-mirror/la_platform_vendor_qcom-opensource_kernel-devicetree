// SPDX-License-Identifier: BSD-3-Clause
/*
 * Copyright (c) Qualcomm Technologies, Inc. and/or its subsidiaries.
 */

#include "sdxbaagha-qmp.dtsi"

&soc {
};

&ipa_hw {
	qcom,ipa-eth-pdu-enable;
};
