// SPDX-License-Identifier: BSD-3-Clause
/*
 * Copyright (c) Qualcomm Technologies, Inc. and/or its subsidiaries.
 */

#include "sdxbaagha-128m-mtp.dtsi"

&smb_int_default {
	pins = "gpio5";
};

&smb23x_charger {
	interrupts = <0x0 0x8C 0x0 IRQ_TYPE_LEVEL_LOW>;
};
