/dts-v1/;

#include "sdxpinn.dtsi"
#include "sdxpinn-idp-m2-v3.dtsi"

/ {
	model = "Qualcomm Technologies, Inc. SDXPINN IDP M2 V3";
	compatible = "qcom,sdxpinn-idp",
			"qcom,sdxpinn", "qcom,idp";
	qcom,board-id = <0x4030022 0x304>;
};
