// SPDX-License-Identifier: BSD-3-Clause
/*
 * Copyright (c) Qualcomm Technologies, Inc. and/or its subsidiaries.
 */

/dts-v1/;

#include "holi.dtsi"
#include "holi-cdp.dtsi"

/ {
	model = "Qualcomm Technologies, Inc. Holi CDP";
	compatible = "qcom,holi-cdp", "qcom,holi", "qcom,cdp";
	qcom,board-id = <1 0>;
};
