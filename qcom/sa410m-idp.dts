// SPDX-License-Identifier: BSD-3-Clause
/*
 * Copyright (c) Qualcomm Technologies, Inc. and/or its subsidiaries.
 */

/dts-v1/;

#include "sa410m.dtsi"
#include "sa410m-idp.dtsi"

/ {
	model = "Qualcomm Technologies, Inc. SA410M IDP";
	compatible = "qcom,sa410m", "qcom,idp", "qcom,sa410m-idp";
	qcom,msm-id = <441 0x10000>, <471 0x10000>;
	qcom,board-id = <34 0x0>;
};

