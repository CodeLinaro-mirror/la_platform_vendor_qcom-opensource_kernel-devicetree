// SPDX-License-Identifier: BSD-3-Clause
/*
 * Copyright (c) Qualcomm Technologies, Inc. and/or its subsidiaries.
 */

/dts-v1/;

#include "holi.dtsi"
#include "holi-mtp.dtsi"

/ {
	model = "Qualcomm Technologies, Inc. Holi MTP";
	compatible = "qcom,holi-mtp", "qcom,holi", "qcom,mtp";
	qcom,board-id = <8 0>;
};

