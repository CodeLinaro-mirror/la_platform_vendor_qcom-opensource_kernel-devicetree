// SPDX-License-Identifier: BSD-3-Clause
/*
 * Copyright (c) Qualcomm Technologies, Inc. and/or its subsidiaries.
 */

/dts-v1/;

#include "yupikp.dtsi"
#include "yupikp-idp.dtsi"

/ {
	model = "Qualcomm Technologies, Inc. YUPIKP-IOT IDP";
	compatible = "qcom,yupikp-iot-idp", "qcom,yupikp-iot", "qcom,idp";
	qcom,board-id = <34 0>;
};
