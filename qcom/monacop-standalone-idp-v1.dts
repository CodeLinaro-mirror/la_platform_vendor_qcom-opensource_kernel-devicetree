// SPDX-License-Identifier: BSD-3-Clause
/*
 * Copyright (c) Qualcomm Technologies, Inc. and/or its subsidiaries.
 */

/dts-v1/;

#include "monacop-standalone-1gb.dtsi"
#include "monaco-standalone-idp-v1.dtsi"

/ {
	model = "Qualcomm Technologies, Inc. Monaco standalone IDP V1.0";
	compatible = "qcom,monaco", "qcom,idp";
	qcom,board-id = <0x010022 0x301>;
};
