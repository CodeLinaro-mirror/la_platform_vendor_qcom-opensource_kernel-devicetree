// SPDX-License-Identifier: BSD-3-Clause
/*
 * Copyright (c) Qualcomm Technologies, Inc. and/or its subsidiaries.
 */

/dts-v1/;

#include "sdxpinn.dtsi"
#include "sdxpinn-idp-cpe.dtsi"
#include "sdxpinn-reserved-memory-2G.dtsi"

/ {
	model = "Qualcomm Technologies, Inc. SDXPINN IDP CPE";
	compatible = "qcom,sdxpinn-idp",
			"qcom,sdxpinn", "qcom,idp";
	qcom,board-id = <0x3010022 0x403>;
};
