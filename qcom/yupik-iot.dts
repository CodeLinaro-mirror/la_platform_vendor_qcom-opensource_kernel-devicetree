// SPDX-License-Identifier: BSD-3-Clause
/*
 * Copyright (c) Qualcomm Technologies, Inc. and/or its subsidiaries.
 */

/dts-v1/;

#include "yupik-iot.dtsi"

/ {
	model = "Qualcomm Technologies, Inc. YUPIK-IOT SoC";
	compatible = "qcom,yupik-iot";
	qcom,board-id = <0 0>;
};
