// SPDX-License-Identifier: BSD-3-Clause
/*
 * Copyright (c) Qualcomm Technologies, Inc. and/or its subsidiaries.
 */

#include "sa410m.dtsi"

/ {
	model = "Qualcomm Technologies, Inc. SA410M RUMI";
	compatible = "qcom,sa410m-rumi", "qcom,rumi";
	qcom,msm-id=<560 0x10000>;
};
