// SPDX-License-Identifier: BSD-3-Clause
/*
 * Copyright (c) Qualcomm Technologies, Inc. and/or its subsidiaries.
 */

/dts-v1/;

#include "qcs610.dtsi"
#include "qcs610-ipc.dtsi"

/ {
	model = "Qualcomm Technologies, Inc. QCS610 IPC";
	compatible = "qcom,qcs610-iot", "qcom,qcs610", "qcom,iot";
	qcom,board-id = <32 1>;
};
