// SPDX-License-Identifier: BSD-3-Clause
/*
 * Copyright (c) Qualcomm Technologies, Inc. and/or its subsidiaries.
 */

/dts-v1/;

#include "yupikp.dtsi"
#include "yupikp-qrd.dtsi"

/ {
	model = "Qualcomm Technologies, Inc. YupikP QRD";
	compatible = "qcom,yupikp-qrd", "qcom,yupikp", "qcom,qrd";
	qcom,board-id = <0x1000B 0>;
};
