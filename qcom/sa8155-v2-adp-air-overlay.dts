// SPDX-License-Identifier: BSD-3-Clause
/*
 * Copyright (c) Qualcomm Technologies, Inc. and/or its subsidiaries.
 */

/dts-v1/;
/plugin/;

#include "sa8155-adp-common.dtsi"
#include "display/sa8155-adp-star-display.dtsi"
#include "display/sa8155-adp-star-display-shd.dtsi"

/ {
	compatible = "qcom,sa8155-v2-adp-air", "qcom,sa8155",
		"qcom,adp-air";
	qcom,board-id = <0X01000019 0>;
};
