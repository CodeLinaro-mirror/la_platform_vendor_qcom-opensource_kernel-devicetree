// SPDX-License-Identifier: BSD-3-Clause
/*
 * Copyright (c) Qualcomm Technologies, Inc. and/or its subsidiaries.
 */

#include "sa415m-audio-overlay.dtsi"

&soc {
	sound-tavil {
		qcom,wsa-max-devs = <1>;
		qcom,wsa-devs = <&wsa881x_0214>;
		qcom,wsa-aux-dev-prefix = "SpkrRight";
	};
};
