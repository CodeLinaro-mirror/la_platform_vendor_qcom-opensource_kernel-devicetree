// SPDX-License-Identifier: BSD-3-Clause
/*
 * Copyright (c) Qualcomm Technologies, Inc. and/or its subsidiaries.
 */

/dts-v1/;

#include "qcs410.dtsi"
#include "qcs410-opk.dtsi"

/ {
	model = "Qualcomm Technologies, Inc. QCS410 Openkit";
	compatible = "qcom,qcs410-opk", "qcom,qcs410", "qcom,opk";
	qcom,board-id = <32 3>;
};
