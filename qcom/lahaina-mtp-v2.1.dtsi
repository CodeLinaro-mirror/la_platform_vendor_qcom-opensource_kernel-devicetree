// SPDX-License-Identifier: BSD-3-Clause
/*
 * Copyright (c) Qualcomm Technologies, Inc. and/or its subsidiaries.
 */

#include "lahaina-mtp.dtsi"
#include "display/lahaina-sde-display-mtp-v2.1.dtsi"
