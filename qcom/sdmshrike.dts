// SPDX-License-Identifier: BSD-3-Clause
/*
 * Copyright (c) Qualcomm Technologies, Inc. and/or its subsidiaries.
 */

/dts-v1/;

#include "sdmshrike.dtsi"

/ {
	model = "Qualcomm Technologies, Inc. SDMSHRIKE SoC";
	compatible = "qcom,sdmshrike";
	qcom,pmic-name = "PM8150";
	qcom,board-id = <0 0>;
};
