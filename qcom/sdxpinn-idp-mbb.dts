// SPDX-License-Identifier: BSD-3-Clause
/*
 * Copyright (c) Qualcomm Technologies, Inc. and/or its subsidiaries.
 */

/dts-v1/;

#include "sdxpinn.dtsi"
#include "sdxpinn-idp-mbb.dtsi"

/ {
	model = "Qualcomm Technologies, Inc. SDXPINN IDP MBB";
	compatible = "qcom,sdxpinn-idp",
		"qcom,sdxpinn", "qcom,idp";
	qcom,board-id = <0x2010022 0x302>, <0x2010022 0x402>;
};
