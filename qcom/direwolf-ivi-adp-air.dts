// SPDX-License-Identifier: BSD-3-Clause
/*
 * Copyright (c) Qualcomm Technologies, Inc. and/or its subsidiaries.
 */

/dts-v1/;

#include "direwolf-ivi.dtsi"
#include "direwolf-adp-air.dtsi"

/ {
	model = "Qualcomm Technologies, Inc. DirewolfAU IVI ADP-AIR";
	compatible = "qcom,direwolf-ivi-adp-air", "qcom,direwolf-ivi",
		"qcom,direwolf", "qcom,adp-air";
	qcom,board-id = <0x01010019 0>;
};
