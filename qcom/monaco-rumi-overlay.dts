// SPDX-License-Identifier: BSD-3-Clause
/*
 * Copyright (c) Qualcomm Technologies, Inc. and/or its subsidiaries.
 */

/dts-v1/;
/plugin/;

#include "monaco-rumi.dtsi"

/ {
	model = "Qualcomm Technologies, Inc. Monaco RUMI";
	qcom,board-id = <15 0>;
};
