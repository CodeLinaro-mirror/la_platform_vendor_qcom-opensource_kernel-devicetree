// SPDX-License-Identifier: BSD-3-Clause
/*
 * Copyright (c) Qualcomm Technologies, Inc. and/or its subsidiaries.
 */

/dts-v1/;

#include "sdxlemur.dtsi"
#include "sdxlemur-mtp-mbb-pcie-rc-ep.dtsi"
#include "sdxlemur-512mb.dtsi"

/ {
	model = "Qualcomm Technologies, Inc. SDXLEMUR MTP MBB RC PCIE-EP";
	compatible = "qcom,sdxlemur-mtp",
		"qcom,sdxlemur", "qcom,mtp";
	qcom,board-id = <0x3010008 0x203>;
};
