/dts-v1/;

#include "sdxbaagha-128m.dtsi"
#include "sdxbaagha-128m-rumi.dtsi"

/ {
	model = "Qualcomm Technologies, Inc. SDXBAAGHA RUMI 128M";
	compatible = "qcom,sdxbaagha-rumi",
		"qcom,sdxbaagha", "qcom,rumi";
	qcom,board-id = <0x0F 0x400>, <0x0F 0x700>;
};
