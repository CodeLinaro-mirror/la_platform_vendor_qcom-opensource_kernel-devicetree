// SPDX-License-Identifier: BSD-3-Clause
/*
 * Copyright (c) Qualcomm Technologies, Inc. and/or its subsidiaries.
 */

&soc {
	mdss_qpic: qcom,msm_qpic@1c98000 {
		compatible = "qcom,mdss_qpic";

		reg = <0x1c98000 0x24000>;
		reg-names = "qpic_base";

		interrupts = <GIC_SPI 75 IRQ_TYPE_LEVEL_HIGH>;
		interrupt-names = "qpic_irq";

		interconnect-names = "qpic-display-data-bus";
		interconnects = <&aggre_noc MASTER_QPIC &mc_virt SLAVE_EBI1>;
		qcom,msm-bus,name = "mdss_qpic";
		qcom,msm-bus,num-cases = <2>;
		qcom,msm-bus,num-paths = <1>;

		qcom,msm-bus,vectors-KBps =
			<0 0>,
			/* Voting for max b/w on PNOC bus for now */
			<400000 800000>;

		qcom,panel-name = "ili_qvga";

		qcom,rst-gpio = <&tlmm 89 0>;
		qcom,cs-gpio = <&tlmm 94 0>;
		qcom,ad8-gpio = <&tlmm 93 0>;
		qcom,panel-te-gpio = <&tlmm 88 0>;
		qcom,panel-bl-gpio = <&pmx35_gpios 5 0>;

		clocks = <&rpmhcc RPMH_QPIC_CLK>;
		clock-names = "core_clk";

		pinctrl-names= "qpic_display_default", "qpic_display_sleep";
		pinctrl-0 = <&qpic_cs_active &qpic_te_active
			&qpic_rs_active &qpic_ad_active
			&display_bl_en>;
		pinctrl-1 = <&qpic_cs_sleep &qpic_te_sleep
			&qpic_rs_sleep &qpic_ad_sleep>;

		iommus = <&apps_smmu 0x160 0x3>;
		qcom,iommu-dma = "atomic";
	};
};
