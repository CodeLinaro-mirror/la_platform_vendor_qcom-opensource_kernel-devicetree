// SPDX-License-Identifier: BSD-3-Clause
/*
 * Copyright (c) Qualcomm Technologies, Inc. and/or its subsidiaries.
 */

/dts-v1/;

#include "yupik-vm.dtsi"
#include "yupik-vm-qrd.dtsi"

/ {
	model = "Qualcomm Technologies, Inc. Yupik VM QRD";
	compatible = "qcom,yupik-qrd", "qcom,yupik", "qcom,qrd";
	qcom,board-id = <0x1000B 0>;
};
