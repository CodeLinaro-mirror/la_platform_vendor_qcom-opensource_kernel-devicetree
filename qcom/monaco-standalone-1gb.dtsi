// SPDX-License-Identifier: BSD-3-Clause
/*
 * Copyright (c) Qualcomm Technologies, Inc. and/or its subsidiaries.
 */

#include "monaco.dtsi"

/ {
	reserved-memory {
		/delete-node/oda_region@45700000;
	};
};

&removed_region {
	reg = <0x0 0x60e00000 0x0 0x01100000>;
};

&xbl_aop_mem {
	reg = <0x0 0x45e00000 0x0 0x110000>;
};
