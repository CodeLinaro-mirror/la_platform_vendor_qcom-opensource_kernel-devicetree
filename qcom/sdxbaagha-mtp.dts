// SPDX-License-Identifier: BSD-3-Clause
/*
 * Copyright (c) Qualcomm Technologies, Inc. and/or its subsidiaries.
 */

/dts-v1/;

#include "sdxbaagha.dtsi"
#include "sdxbaagha-mtp.dtsi"

/ {
	model = "Qualcomm Technologies, Inc. SDXBAAGHA MTP 256M";
	compatible = "qcom,sdxbaagha-mtp",
		"qcom,sdxbaagha", "qcom,mtp";
	qcom,board-id = <0x10008 0x103>, <0x10008 0x203>;
};
