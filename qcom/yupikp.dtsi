// SPDX-License-Identifier: BSD-3-Clause
/*
 * Copyright (c) Qualcomm Technologies, Inc. and/or its subsidiaries.
 */

#include "yupik.dtsi"

/ {
	model = "Qualcomm Technologies, Inc. YupikP";
	compatible = "qcom,yupikp";
	qcom,msm-id = <499 0x10000>;
};
