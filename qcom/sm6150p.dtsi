// SPDX-License-Identifier: BSD-3-Clause
/*
 * Copyright (c) Qualcomm Technologies, Inc. and/or its subsidiaries.
 */

#include "sm6150.dtsi"

/ {
	model = "Qualcomm Technologies, Inc. SM6150P";
	qcom,msm-name = "SM6150P";
	qcom,msm-id = <369 0>;
};
