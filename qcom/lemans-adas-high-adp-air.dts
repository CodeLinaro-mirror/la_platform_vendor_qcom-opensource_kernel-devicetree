// SPDX-License-Identifier: BSD-3-Clause
/*
 * Copyright (c) Qualcomm Technologies, Inc. and/or its subsidiaries.
 */

/dts-v1/;

#include "lemans-adas-high.dtsi"
#include "lemans-adp-air.dtsi"

/ {
	model = "Qualcomm Technologies, Inc. Lemans ADAS HIGH ADP AIR";
	compatible = "qcom,lemans-adas-high", "qcom,lemans", "qcom,adp-air", "qcom,lemans-adas-high-adp-air";
};
