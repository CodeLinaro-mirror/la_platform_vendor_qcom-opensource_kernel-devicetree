// SPDX-License-Identifier: BSD-3-Clause
/*
 * Copyright (c) Qualcomm Technologies, Inc. and/or its subsidiaries.
 */

/dts-v1/;

#include "direwolf-ivi.dtsi"

/ {
	model = "Qualcomm Technologies, Inc. DirewolfAU IVI SoC";
	compatible = "qcom,direwolf-ivi", "qcom,direwolf";
	qcom,board-id = <0 0>;
};
