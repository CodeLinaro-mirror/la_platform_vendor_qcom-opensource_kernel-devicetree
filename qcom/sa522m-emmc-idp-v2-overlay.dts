/dts-v1/;
/plugin/;

#include "sa525m-idp.dtsi"
#include "sa525m-dsmharq-70m.dtsi"

/ {
	model = "Qualcomm Technologies, Inc. SA522 EMMC IDP V2 Overlay";
	compatible = "qcom,sdxpinn-idp",
		"qcom,sdxpinn", "qcom,idp";
	qcom,msm-id=<559 0x10000>;
	qcom,board-id = <0x0020022 0>;
};

&qnand_1 {
	status = "disabled";
};
