// SPDX-License-Identifier: BSD-3-Clause
/*
 * Copyright (c) Qualcomm Technologies, Inc. and/or its subsidiaries.
 */

/dts-v1/;

#include "katmai-iot-odk-lcd.dtsi"

&pcie1 {
	status = "ok";
};

&pcie1_msi {
	status = "ok";
};

&gcc_pcie_1_gdsc {
	status = "ok";
};
