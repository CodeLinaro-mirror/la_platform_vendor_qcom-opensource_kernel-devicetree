// SPDX-License-Identifier: BSD-3-Clause
/*
 * Copyright (c) Qualcomm Technologies, Inc. and/or its subsidiaries.
 */

/dts-v1/;

#include "monacop.dtsi"
#include "monaco-wdp-v1.dtsi"

/ {
	model = "Qualcomm Technologies, Inc. Monaco WDP V1.0";
	compatible = "qcom,monaco", "qcom,wdp";
	qcom,board-id = <0x010024 0x0>;
};
