// SPDX-License-Identifier: BSD-3-Clause
/*
 * Copyright (c) Qualcomm Technologies, Inc. and/or its subsidiaries.
 */

/dts-v1/;

#include "qrb5165.dtsi"
#include "kona-v2.1-iot-rb5.dtsi"

/ {
	model = "Qualcomm Technologies, Inc. qrb5165 IOT RB5";
	compatible = "qcom,kona-iot", "qcom,kona", "qcom,iot";
	qcom,board-id = <11 3>;
};
