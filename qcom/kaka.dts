// SPDX-License-Identifier: BSD-3-Clause
/*
 * Copyright (c) Qualcomm Technologies, Inc. and/or its subsidiaries.
 */

/dts-v1/;

#include "kaka.dtsi"

/ {
	model = "Qualcomm Technologies, Inc. Kaka SoC";
	compatible = "qcom,kaka";
	qcom,board-id = <0 0>;
};
