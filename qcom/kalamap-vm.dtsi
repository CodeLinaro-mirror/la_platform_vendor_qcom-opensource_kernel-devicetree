// SPDX-License-Identifier: BSD-3-Clause
/*
 * Copyright (c) Qualcomm Technologies, Inc. and/or its subsidiaries.
 */

#include "kalama-vm.dtsi"

/ {
	model = "Qualcomm Technologies, Inc. KalamaP SVM";
	compatible = "qcom,kalamap";
	qcom,msm-id = <536 0x10000>, <536 0x20000>;
};
