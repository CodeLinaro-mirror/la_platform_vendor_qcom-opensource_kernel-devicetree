// SPDX-License-Identifier: BSD-3-Clause
/*
 * Copyright (c) Qualcomm Technologies, Inc. and/or its subsidiaries.
 */

/dts-v1/;

#include "katmai.dtsi"
#include "yupik-iot-hsp-pm7250b.dtsi"

/ {
	model = "Qualcomm Technologies, Inc. Katmai HSP + PM7250B";
	compatible = "qcom,yupik-iot-idp", "qcom,yupik-iot", "qcom,idp";
	qcom,board-id = <34 1>;
};
