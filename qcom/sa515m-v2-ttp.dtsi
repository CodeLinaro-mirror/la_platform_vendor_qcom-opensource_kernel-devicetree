// SPDX-License-Identifier: BSD-3-Clause
/*
 * Copyright (c) Qualcomm Technologies, Inc. and/or its subsidiaries.
 */

#include "sa515m-v2.dtsi"
#include "sdx55-mtp.dtsi"

&vbus_detect {
	status = "okay";
};
