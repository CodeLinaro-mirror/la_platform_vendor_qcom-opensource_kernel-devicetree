// SPDX-License-Identifier: BSD-3-Clause
/*
 * Copyright (c) Qualcomm Technologies, Inc. and/or its subsidiaries.
 */

/dts-v1/;

#include "sdxlemur-v2.dtsi"
#include "sdxlemur-mtp.dtsi"
#include "sdxlemur-1024mb.dtsi"
#include "sdxlemur-audio.dtsi"
#include "sdxlemur-mtp-audio-overlay.dtsi"

/ {
	model = "Qualcomm Technologies, Inc. SDXLEMUR MTP V2";
	compatible = "qcom,sdxlemur-mtp",
		"qcom,sdxlemur", "qcom,mtp";
	qcom,board-id = <0x20008 0x300>;
};
