// SPDX-License-Identifier: BSD-3-Clause
/*
 * Copyright (c) Qualcomm Technologies, Inc. and/or its subsidiaries.
 */

/dts-v1/;

#include "direwolf-ivi-v2.dtsi"

/ {
	model = "Qualcomm Technologies, Inc. DirewolfAU IVI V2 SoC";
	compatible = "qcom,direwolf-ivi", "qcom,direwolf";
	qcom,board-id = <0 0>;
};
