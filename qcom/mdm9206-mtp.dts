/dts-v1/;

#include "mdm9607-mtp.dtsi"
#include "mdm9206.dtsi"

/ {
	model = "Qualcomm Technologies, Inc. MDM 9206 MTP";
	compatible = "qcom,mdm9607-mtp", "qcom,mdm9607", "qcom,mtp";
	qcom,board-id = <8 0>;
};
