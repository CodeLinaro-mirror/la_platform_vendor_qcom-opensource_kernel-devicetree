// SPDX-License-Identifier: BSD-3-Clause
/*
 * Copyright (c) Qualcomm Technologies, Inc. and/or its subsidiaries.
 */

/dts-v1/;

#include "shima.dtsi"
#include "shima-idps-digital-mics.dtsi"

/ {
	model = "Qualcomm Technologies, Inc. Shima IDPS + DIGITAL MICS";
	compatible = "qcom,shima-idp", "qcom,shima", "qcom,idp";
	qcom,board-id = <34 1>;
};
