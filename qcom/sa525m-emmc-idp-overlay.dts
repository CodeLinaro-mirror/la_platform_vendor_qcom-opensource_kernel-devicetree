/dts-v1/;
/plugin/;

#include "sa525m-idp.dtsi"
#include "sa525m-dsmharq-58m.dtsi"

/ {
	model = "Qualcomm Technologies, Inc. SA525 EMMC IDP Overlay";
	compatible = "qcom,sdxpinn-idp",
		"qcom,sdxpinn", "qcom,idp";
	qcom,msm-id=<558 0x10000>;
	qcom,board-id = <0x0010022 0>;
};

&qnand_1 {
	status = "disabled";
};
