// SPDX-License-Identifier: BSD-3-Clause
/*
 * Copyright (c) Qualcomm Technologies, Inc. and/or its subsidiaries.
 */

/dts-v1/;
/plugin/;

#include "lemans-rumi.dtsi"

/ {
	model = "Qualcomm Technologies, Inc. Lemans RUMI";
	compatible = "qcom,lemans", "qcom,rumi", "qcom,lemans-rumi";
	qcom,board-id = <0x1000F 0>;
};
