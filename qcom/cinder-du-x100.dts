// SPDX-License-Identifier: BSD-3-Clause
/*
 * Copyright (c) Qualcomm Technologies, Inc. and/or its subsidiaries.
 */

/dts-v1/;

#include "cinder.dtsi"
#include "cinder-du.dtsi"
#include "cinder-du-hireg.dtsi"
#include "cinder-x100.dtsi"

/ {
	model = "Qualcomm Technologies, Inc. Cinder DU X100";
	compatible = "qcom,cinder-x100", "qcom,cinder", "qcom,x100";
	qcom,board-id = <0x27 0x0>;
};
