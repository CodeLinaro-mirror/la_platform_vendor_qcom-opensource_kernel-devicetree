// SPDX-License-Identifier: BSD-3-Clause
/*
 * Copyright (c) Qualcomm Technologies, Inc. and/or its subsidiaries.
 */

#include "lemans.dtsi"

/ {
	model = "Qualcomm Technologies, Inc. LeMans ADAS HIGH SoC";
	compatible = "qcom,lemans-adas-high", "qcom,lemans";
	qcom,msm-id = <533 0x10000>;
};
