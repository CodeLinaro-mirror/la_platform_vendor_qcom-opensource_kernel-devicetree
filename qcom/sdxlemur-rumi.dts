// SPDX-License-Identifier: BSD-3-Clause
/*
 * Copyright (c) Qualcomm Technologies, Inc. and/or its subsidiaries.
 */

/dts-v1/;

#include "sdxlemur.dtsi"
#include "sdxlemur-rumi.dtsi"
#include "sdxlemur-1024mb.dtsi"
#include "sdxlemur-audio.dtsi"
#include "sdxlemur-mtp-audio-overlay.dtsi"

/ {
	model = "Qualcomm Technologies, Inc. SDXLEMUR RUMI";
	compatible = "qcom,sdxlemur-rumi",
		"qcom,sdxlemur", "qcom,rumi";
	qcom,board-id = <0x0F 0>;
};
