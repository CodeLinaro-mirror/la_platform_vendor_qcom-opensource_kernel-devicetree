// SPDX-License-Identifier: BSD-3-Clause
/*
 * Copyright (c) Qualcomm Technologies, Inc. and/or its subsidiaries.
 */

/dts-v1/;

#include "waipio-oemvm.dtsi"
#include "waipio-oemvm-rumi.dtsi"

/ {
	model = "Qualcomm Technologies, Inc. Waipio SVM RUMI";
	compatible = "qcom,waipio-rumi", "qcom,waipio", "qcom,rumi";
	qcom,board-id = <15 0>;
};
