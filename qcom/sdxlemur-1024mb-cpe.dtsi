// SPDX-License-Identifier: BSD-3-Clause
/*
 * Copyright (c) Qualcomm Technologies, Inc. and/or its subsidiaries.
 */

#include "sdxlemur-1024mb.dtsi"

&mpss_adsp_mem {
	reg = <0x90800000 0x12000000>;
};
