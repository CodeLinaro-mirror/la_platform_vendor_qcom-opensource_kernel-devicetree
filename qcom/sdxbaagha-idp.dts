/dts-v1/;

#include "sdxbaagha.dtsi"
#include "sdxbaagha-idp.dtsi"

/ {
	model = "Qualcomm Technologies, Inc. SDXBAAGHA IDP 256M";
	compatible = "qcom,sdxbaagha-idp",
		"qcom,sdxbaagha", "qcom,idp";
	qcom,board-id = <0x10022 0x100>, <0x10022 0x200>;
};
