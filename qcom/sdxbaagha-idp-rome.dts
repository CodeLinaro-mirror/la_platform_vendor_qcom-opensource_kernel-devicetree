/dts-v1/;

#include "sdxbaagha.dtsi"
#include "sdxbaagha-idp.dtsi"
#include "sdxbaagha-idp-rome.dtsi"

/ {
	model = "Qualcomm Technologies, Inc. SDXBAAGHA IDP 256M ROME";
	compatible = "qcom,sdxbaagha-idp",
		"qcom,sdxbaagha", "qcom,idp";
	qcom,board-id = <0x10022 0x101>, <0x10022 0x201>;
};
