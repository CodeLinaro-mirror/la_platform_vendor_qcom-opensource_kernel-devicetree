// SPDX-License-Identifier: BSD-3-Clause
/*
 * Copyright (c) Qualcomm Technologies, Inc. and/or its subsidiaries.
 */

#include "kalama-v2.dtsi"

/ {
	model = "Qualcomm Technologies, Inc. KalamaP v2 SoC";
	compatible = "qcom,kalamap";
	qcom,msm-id = <536 0x20000>;
};
