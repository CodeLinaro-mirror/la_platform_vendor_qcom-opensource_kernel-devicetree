// SPDX-License-Identifier: BSD-3-Clause
/*
 * Copyright (c) Qualcomm Technologies, Inc. and/or its subsidiaries.
 */

/dts-v1/;

#include "kalamap-oemvm.dtsi"
#include "kalamap-oemvm-hhg.dtsi"

/ {
	model = "Qualcomm Technologies, Inc. KalamaP OEMVM HHG";
	compatible = "qcom,kalamap-hhg", "qcom,kalamap", "qcom,hhg";
	qcom,board-id = <0x1001f 0x1>;
};
