// SPDX-License-Identifier: BSD-3-Clause
/*
 * Copyright (c) Qualcomm Technologies, Inc. and/or its subsidiaries.
 */

/dts-v1/;

#include "sdxbaagha.dtsi"
#include "sdxbaagha-rcm-rome.dtsi"

/ {
	model = "Qualcomm Technologies, Inc. SDXBAAGHA RCM 256M ROME";
	compatible = "qcom,sdxbaagha-rcm",
		"qcom,sdxbaagha", "qcom,rcm";
	qcom,board-id = <0x10015 0x203>, <0x10015 0x103>;
};
