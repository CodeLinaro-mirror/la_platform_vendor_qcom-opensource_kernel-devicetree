// SPDX-License-Identifier: BSD-3-Clause
/*
 * Copyright (c) Qualcomm Technologies, Inc. and/or its subsidiaries.
 */

/dts-v1/;

#include "direwolf-vm.dtsi"
#include "direwolf-vm-la1-mt.dtsi"

/ {
	model = "Qualcomm Technologies, Inc. Direwolf Multi LA1 Virtual Machine";
	compatible = "qcom,direwolf", "qcom,quinvm";
	qcom,board-id = <0 0x3000001>;
};

