// SPDX-License-Identifier: BSD-3-Clause
/*
 * Copyright (c) Qualcomm Technologies, Inc. and/or its subsidiaries.
 */

/dts-v1/;

#include "cinder.dtsi"

/ {
	model = "Qualcomm Technologies, Inc. Cinder SoC";
	compatible = "qcom,cinder";
	qcom,board-id = <0x0 0x0>;
};
