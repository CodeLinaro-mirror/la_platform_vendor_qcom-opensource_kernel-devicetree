// SPDX-License-Identifier: BSD-3-Clause
/*
 * Copyright (c) Qualcomm Technologies, Inc. and/or its subsidiaries.
 */

/dts-v1/;

#include "kalamap.dtsi"

/ {
	model = "Qualcomm Technologies, Inc. KalamaP SoC";
	compatible = "qcom,kalamap";
	qcom,board-id = <0 0>;
};
