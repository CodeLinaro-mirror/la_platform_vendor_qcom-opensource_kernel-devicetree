// SPDX-License-Identifier: BSD-3-Clause
/*
 * Copyright (c) Qualcomm Technologies, Inc. and/or its subsidiaries.
 */

#include "sdxbaagha-128m-rcm.dtsi"

&ethqos_hw {
	status = "disabled";
};

&smb23x_charger {
	status = "disabled";
};
