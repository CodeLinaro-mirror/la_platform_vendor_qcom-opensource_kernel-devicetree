/dts-v1/;

#include "sa525m.dtsi"
#include "sa525m-dma-heaps.dtsi"
#include "sa525m-reserved-memory.dtsi"
#include "sa525-gvms.dtsi"
#include "sa525m-hostvm.dtsi"
#include "sa525m-dsmharq-38m.dtsi"

/ {
	model = "Qualcomm Technologies, Inc. SA525M HOST VM V3";
	compatible = "qcom,sdxpinn";
	qcom,msm-id= <558 0x10000>;
	qcom,board-id = <0x30000 0>;
};
