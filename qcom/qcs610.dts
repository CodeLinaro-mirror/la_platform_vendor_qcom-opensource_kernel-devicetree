// SPDX-License-Identifier: BSD-3-Clause
/*
 * Copyright (c) Qualcomm Technologies, Inc. and/or its subsidiaries.
 */

/dts-v1/;

#include "qcs610.dtsi"

/ {
	model = "Qualcomm Technologies, Inc. QCS610 SoC";
	compatible = "qcom,qcs610";
	qcom,board-id = <0 0>;
};
