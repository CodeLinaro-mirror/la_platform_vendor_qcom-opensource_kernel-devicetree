// SPDX-License-Identifier: BSD-3-Clause
/*
 * Copyright (c) Qualcomm Technologies, Inc. and/or its subsidiaries.
 */

/ {
	model = "Qualcomm Technologies, Inc. Lemans ADP";
	compatible =  "qcom,lemans", "qcom,adp";
	qcom,board-id = <25 0>;
};

&soc {
};
