// SPDX-License-Identifier: BSD-3-Clause
/*
 * Copyright (c) Qualcomm Technologies, Inc. and/or its subsidiaries.
 */

/dts-v1/;

#include "sa525m.dtsi"
#include "sa525m-dma-heaps.dtsi"
#include "sa525m-reserved-memory.dtsi"
#include "sa525-gvms.dtsi"
#include "sa525m-hostvm.dtsi"
#include "sa525m-dsmharq-70m.dtsi"

/ {
	model = "Qualcomm Technologies, Inc. SA525M HOST VM";
	compatible = "qcom,sdxpinn";
	qcom,msm-id= <558 0x10000>;
	qcom,board-id = <0 0>;
};
