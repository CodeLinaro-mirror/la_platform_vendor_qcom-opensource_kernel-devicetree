// SPDX-License-Identifier: BSD-3-Clause
/*
 * Copyright (c) Qualcomm Technologies, Inc. and/or its subsidiaries.
 */

/dts-v1/;

#include "direwolf-adas.dtsi"

/ {
	model = "Qualcomm Technologies, Inc. DirewolfAU v1 ADAS SoC";
	compatible = "qcom,direwolf-adas", "qcom,direwolf";
	qcom,board-id = <0 0>;
};
