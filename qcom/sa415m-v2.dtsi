// SPDX-License-Identifier: BSD-3-Clause
/*
 * Copyright (c) Qualcomm Technologies, Inc. and/or its subsidiaries.
 */

/ {
	model = "Qualcomm Technologies, Inc. SDXPOORWILLS V2";
	compatible = "qcom,sdxpoorwills";
	qcom,msm-id = <334 0x20000>, <335 0x20000>, <408 0x20000>;
};
