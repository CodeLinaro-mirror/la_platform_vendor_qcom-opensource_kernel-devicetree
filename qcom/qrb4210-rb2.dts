// SPDX-License-Identifier: BSD-3-Clause
/*
 * Copyright (c) Qualcomm Technologies, Inc. and/or its subsidiaries.
 */

/dts-v1/;

#include "bengal.dtsi"
#include "bengal-qrd.dtsi"

/ {
	model = "Qualcomm Technologies, Inc. BENGAL QRD";
	compatible = "qcom,bengal";
	qcom,board-id = <0x0501000B 0x0>;
};
