/dts-v1/;

#include "sa525m.dtsi"
#include "sa525m-dma-heaps.dtsi"
#include "sa525m-reserved-memory.dtsi"
#include "sa525-gvms.dtsi"
#include "sa525m-hostvm.dtsi"

/ {
	model = "Qualcomm Technologies, Inc. SA522M HOST VM";
	compatible = "qcom,sdxpinn";
	qcom,msm-id= <559 0x10000>;
	qcom,board-id = <0 0>;
};
