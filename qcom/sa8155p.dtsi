// SPDX-License-Identifier: BSD-3-Clause
/*
 * Copyright (c) Qualcomm Technologies, Inc. and/or its subsidiaries.
 */

#include "sa8155-v1.dtsi"

/ {
	model = "Qualcomm Technologies, Inc. SA8155P ";
	qcom,msm-name = "SA8155P V1";
	compatible = "qcom,sa8155p";
	qcom,msm-id = <367 0x10000>;
};
