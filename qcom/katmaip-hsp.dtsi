// SPDX-License-Identifier: BSD-3-Clause
/*
 * Copyright (c) Qualcomm Technologies, Inc. and/or its subsidiaries.
 */

#include "yupikp-iot-hsp.dtsi"

&pcie1 {
	status = "disabled";
};

&pcie1_msi {
	status = "disabled";
};
