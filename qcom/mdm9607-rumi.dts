// SPDX-License-Identifier: BSD-3-Clause
/*
 * Copyright (c) Qualcomm Technologies, Inc. and/or its subsidiaries.
 */

/dts-v1/;

#include "mdm9607.dtsi"

/ {
	model = "Qualcomm Technologies, Inc. MDM 9607 RUMI";
	compatible = "qcom,mdm9607-rumi", "qcom,mdm9607", "qcom,rumi";
	qcom,board-id = <15 0>;
};

