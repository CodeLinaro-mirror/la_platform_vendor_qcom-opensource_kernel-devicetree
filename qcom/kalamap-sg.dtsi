// SPDX-License-Identifier: BSD-3-Clause
/*
 * Copyright (c) Qualcomm Technologies, Inc. and/or its subsidiaries.
 */

#include "kalamap-v2.dtsi"

/ {
	model = "Qualcomm Technologies, Inc. KalamaP SG";
	compatible = "qcom,kalamap";
	qcom,msm-id = <601 0x20000>;
};
