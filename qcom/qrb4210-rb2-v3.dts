// SPDX-License-Identifier: BSD-3-Clause
/*
 * Copyright (c) Qualcomm Technologies, Inc. and/or its subsidiaries.
 */

/dts-v1/;

#include "bengal.dtsi"
#include "bengal-qrd-v3.dtsi"

/ {
	model = "Qualcomm Technologies, Inc. BENGAL QRD V3";
	compatible = "qcom,bengal";
	qcom,board-id = <0x0503000B 0x0>;
};
