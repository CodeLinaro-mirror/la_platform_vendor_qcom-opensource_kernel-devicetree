// SPDX-License-Identifier: BSD-3-Clause
/*
 * Copyright (c) Qualcomm Technologies, Inc. and/or its subsidiaries.
 */

/dts-v1/;

#include "holi.dtsi"

/ {
	model = "Qualcomm Technologies, Inc. Holi SoC";
	compatible = "qcom,holi";
	qcom,board-id = <0 0>;
};
