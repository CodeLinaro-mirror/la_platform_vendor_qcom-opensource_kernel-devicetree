// SPDX-License-Identifier: BSD-3-Clause
/*
 * Copyright (c) Qualcomm Technologies, Inc. and/or its subsidiaries.
 */

/dts-v1/;

#include "sdxbaagha.dtsi"
#include "sdxbaagha-rumi.dtsi"

/ {
	model = "Qualcomm Technologies, Inc. SDXBAAGHA RUMI";
	compatible = "qcom,sdxbaagha-rumi",
		"qcom,sdxbaagha", "qcom,rumi";
	qcom,board-id = <0x0F 0x400>, <0x0F 0x100>;
};
