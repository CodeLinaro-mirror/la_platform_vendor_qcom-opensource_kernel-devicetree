// SPDX-License-Identifier: BSD-3-Clause
/*
 * Copyright (c) Qualcomm Technologies, Inc. and/or its subsidiaries.
 */

/dts-v1/;
/plugin/;

#include "lemans-qam-star.dtsi"

/ {
	model = "Qualcomm Technologies, Inc. Lemans IVI QAM STAR";
	compatible = "qcom,lemans-ivi", "qcom,lemans", "qcom,qam-star", "qcom,lemans-ivi-qam-star";
	qcom,msm-id = <532 0x10000>;
	qcom,board-id = <0x10025 0>;
};

