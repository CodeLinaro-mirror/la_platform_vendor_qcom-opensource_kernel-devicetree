// SPDX-License-Identifier: BSD-3-Clause
/*
 * Copyright (c) Qualcomm Technologies, Inc. and/or its subsidiaries.
 */

/dts-v1/;

#include "sa410m.dtsi"

/ {
	model = "Qualcomm Technologies, Inc. SA410M SoC";
	compatible = "qcom,sa410m";
	qcom,msm-id = <441 0x10000>, <471 0x10000>;
	qcom,board-id = <0x0 0x0>;
};
