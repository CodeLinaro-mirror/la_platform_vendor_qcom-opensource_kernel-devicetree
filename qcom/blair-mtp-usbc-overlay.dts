// SPDX-License-Identifier: BSD-3-Clause
/*
 * Copyright (c) Qualcomm Technologies, Inc. and/or its subsidiaries.
 */

/dts-v1/;
/plugin/;

#include "blair-mtp-usbc.dtsi"

/ {
	model = "Qualcomm Technologies, Inc. Blair MTP USBC audio";
	compatible = "qcom,blair-mtp", "qcom,blair", "qcom,mtp";
	qcom,msm-id = <507 0x10000>, <578 0x10000>;
	qcom,board-id = <8 1>;
};


