// SPDX-License-Identifier: BSD-3-Clause
/*
 * Copyright (c) Qualcomm Technologies, Inc. and/or its subsidiaries.
 */

/dts-v1/;

#include "sdxlemur-v2.dtsi"
#include "sdxlemur-mtp-mbb-pcie-ep.dtsi"
#include "sdxlemur-512mb.dtsi"

/ {
	model = "Qualcomm Technologies, Inc. SDXLEMUR MTP MBB PCIE-EP V2";
	compatible = "qcom,sdxlemur-mtp",
		"qcom,sdxlemur", "qcom,mtp";
	qcom,board-id = <0x4020008 0x204>;
};
