// SPDX-License-Identifier: BSD-3-Clause
/*
 * Copyright (c) Qualcomm Technologies, Inc. and/or its subsidiaries.
 */

/dts-v1/;

#include "yupik-vm.dtsi"
#include "yupik-vm-idp.dtsi"

/ {
	model = "Qualcomm Technologies, Inc. Yupik VM IDP";
	compatible = "qcom,yupik-idp", "qcom,yupik", "qcom,idp";
	qcom,board-id = <34 0>;
};
