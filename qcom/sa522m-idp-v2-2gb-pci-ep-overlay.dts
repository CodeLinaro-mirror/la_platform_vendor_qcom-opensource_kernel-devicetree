/dts-v1/;
/plugin/;

#include "sa525m-idp.dtsi"
#include "sa525m-reserved-memory-2G.dtsi"
#include "sa525m-dsmharq-58m.dtsi"

/ {
	model = "Qualcomm Technologies, Inc. SA522 IDP V2 2GB PCIe EP Overlay";
	compatible = "qcom,sdxpinn-idp",
		"qcom,sdxpinn", "qcom,idp";
	qcom,msm-id=<559 0x10000>;
	qcom,board-id = <0x0020022 0x406>;
};

#include "sa525m-ep.dtsi"
