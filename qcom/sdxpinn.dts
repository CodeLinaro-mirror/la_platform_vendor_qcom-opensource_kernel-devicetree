// SPDX-License-Identifier: BSD-3-Clause
/*
 * Copyright (c) Qualcomm Technologies, Inc. and/or its subsidiaries.
 */

/dts-v1/;

#include "sdxpinn.dtsi"

/ {
	model = "Qualcomm Technologies, Inc. SDXPINN SoC";
	compatible = "qcom,sdxpinn";
	qcom,board-id = <0 0>;
};
