// SPDX-License-Identifier: BSD-3-Clause
/*
 * Copyright (c) Qualcomm Technologies, Inc. and/or its subsidiaries.
 */

/dts-v1/;
/plugin/;

#include "blair-qrd-nopmi.dtsi"

/ {
	model = "Qualcomm Technologies, Inc. Blair QRD NOPMI";
	compatible = "qcom,blair-qrd", "qcom,blair", "qcom,qrd";
	qcom,msm-id = <507 0x10000>, <578 0x10000>;
	qcom,board-id = <0x1000B 0>;
};

