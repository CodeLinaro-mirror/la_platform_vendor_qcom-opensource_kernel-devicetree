// SPDX-License-Identifier: BSD-3-Clause
/*
 * Copyright (c) Qualcomm Technologies, Inc. and/or its subsidiaries.
 */

/dts-v1/;
/memreserve/ 0x90000000 0x00000100;

#include "yupik.dtsi"
#include "yupik-rumi.dtsi"

/ {
	model = "Qualcomm Technologies, Inc. Yupik RUMI";
	compatible = "qcom,yupik-rumi", "qcom,yupik", "qcom,rumi";
	qcom,board-id = <0x1000f 0>;
};
