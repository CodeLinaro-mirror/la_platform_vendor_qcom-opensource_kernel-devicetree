// SPDX-License-Identifier: BSD-3-Clause
/*
 * Copyright (c) Qualcomm Technologies, Inc. and/or its subsidiaries.
 */

/dts-v1/;
/plugin/;

#include "sa525m-idp.dtsi"
#include "sa525m-gpio_reserve.dtsi"

/ {
	model = "Qualcomm Technologies, Inc. SA525 NAND IDP V3 PCIe EP Overlay";
	compatible = "qcom,sdxpinn-idp",
		"qcom,sdxpinn", "qcom,idp";
	qcom,msm-id=<558 0x10000>;
	qcom,board-id = <0x0010122 0x20006>;
};

#include "sa525m-ep.dtsi"
