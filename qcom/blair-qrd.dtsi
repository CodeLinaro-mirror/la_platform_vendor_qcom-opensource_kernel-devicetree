// SPDX-License-Identifier: BSD-3-Clause
/*
 * Copyright (c) Qualcomm Technologies, Inc. and/or its subsidiaries.
 */

#include "holi-qrd-pm6125.dtsi"

&ufsphy_mem {
	compatible = "qcom,ufs-phy-qmp-v4-yupik";
	vdda-phy-max-microamp = <85700>;
};
