// SPDX-License-Identifier: BSD-3-Clause
/*
 * Copyright (c) Qualcomm Technologies, Inc. and/or its subsidiaries.
 */

/dts-v1/;
/plugin/;

#include "lemans-adp-star.dtsi"

/ {
	model = "Qualcomm Technologies, Inc. Lemans ADAS HIGH ADP STAR";
	compatible = "qcom,lemans", "qcom,adp-star", "qcom,lemans-adas-high", "qcom,lemans-adas-high-adp-star";
	qcom,msm-id = <533 0x10000>;
	qcom,board-id = <0x10019 0>;
};
