// SPDX-License-Identifier: BSD-3-Clause
/*
 * Copyright (c) Qualcomm Technologies, Inc. and/or its subsidiaries.
 */

/dts-v1/;

#include "scuba.dtsi"
#include "scuba-qrd-v3.dtsi"

/ {
	model = "Qualcomm Technologies, Inc. Scuba QRD V3";
	compatible = "qcom,scuba";
	qcom,board-id = <0x0503000B 0x0>;
};
