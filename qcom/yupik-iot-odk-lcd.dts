/dts-v1/;

#include "yupik-iot-odk-lcd.dtsi"

/ {
	model = "Qualcomm Technologies, Inc. Yupik IoT Open Dev Kit + LCD";
	compatible = "qcom,yupik-iot-idp", "qcom,yupik-iot", "qcom,idp";
	qcom,msm-id = <497 0x10000>, <498 0x10000>;
	qcom,board-id = <0x010120 0>;
};
