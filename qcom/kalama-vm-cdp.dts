// SPDX-License-Identifier: BSD-3-Clause
/*
 * Copyright (c) Qualcomm Technologies, Inc. and/or its subsidiaries.
 */

/dts-v1/;

#include "kalama-vm.dtsi"
#include "kalama-vm-cdp.dtsi"

/ {
	model = "Qualcomm Technologies, Inc. Kalama SVM CDP";
	compatible = "qcom,kalama-cdp", "qcom,kalama", "qcom,cdp";
	qcom,board-id = <0x10001 0>;
};
