// SPDX-License-Identifier: BSD-3-Clause
/*
 * Copyright (c) Qualcomm Technologies, Inc. and/or its subsidiaries.
 */

/dts-v1/;

#include "sa8155p-v2.dtsi"
#include "sa8155-adp-star.dtsi"

/ {
	model = "Qualcomm Technologies, Inc. SA8155P IOT V2 ADP STAR";
	compatible = "qcom,sa8155p-adp-star", "qcom,sa8155p", "qcom,sa8155p-iot", "qcom,adp-star";
	qcom,board-id = <25 0>;
};
