// SPDX-License-Identifier: BSD-3-Clause
/*
 * Copyright (c) Qualcomm Technologies, Inc. and/or its subsidiaries.
 */

#include <dt-bindings/arm/msm/msm_ion_ids.h>

&soc {
	qcom,ion {
		compatible = "qcom,msm-ion";
		#address-cells = <1>;
		#size-cells = <0>;

		system_heap: qcom,ion-heap@25 {
			reg = <ION_SYSTEM_HEAP_ID>;
			qcom,ion-heap-type = "MSM_SYSTEM";
		};

		qcom,ion-heap@27 { /* QSEECOM HEAP */
			reg = <ION_QSECOM_HEAP_ID>;
			memory-region = <&common_cma>;
			qcom,ion-heap-type = "DMA";
		};

	};
};

