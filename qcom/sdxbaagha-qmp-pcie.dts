/dts-v1/;

#include "sdxbaagha.dtsi"
#include "sdxbaagha-qmp.dtsi"
#include "sdxbaagha-qmp-pcie.dtsi"

/ {
	model = "Qualcomm Technologies, Inc. SDXBAAGHA QMP 256M PCIE";
	compatible = "qcom,sdxbaagha-qmp",
		"qcom,sdxbaagha", "qcom,qmp";
	qcom,board-id = <0x10022 0x102>;
};
