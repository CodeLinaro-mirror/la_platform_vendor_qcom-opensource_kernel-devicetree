// SPDX-License-Identifier: BSD-3-Clause
/*
 * Copyright (c) Qualcomm Technologies, Inc. and/or its subsidiaries.
 */

/dts-v1/;

#include "qcs410.dtsi"

/ {
	model = "Qualcomm Technologies, Inc. QCS410 SoC";
	compatible = "qcom,qcs410";
	qcom,board-id = <0 0>;
};
