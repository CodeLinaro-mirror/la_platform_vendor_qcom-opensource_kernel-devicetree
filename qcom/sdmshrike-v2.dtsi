// SPDX-License-Identifier: BSD-3-Clause
/*
 * Copyright (c) Qualcomm Technologies, Inc. and/or its subsidiaries.
 */


#include "sdmshrike.dtsi"
/ {
	model = "Qualcomm Technologies, Inc. SA8195 V2";
	qcom,msm-name = "SA8195 V2";
	qcom,msm-id = <340 0x20000>;
};

/delete-node/ &ufs_card_gdsc;
