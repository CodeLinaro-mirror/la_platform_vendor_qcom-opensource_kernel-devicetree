// SPDX-License-Identifier: BSD-3-Clause
/*
 * Copyright (c) Qualcomm Technologies, Inc. and/or its subsidiaries.
 */

/dts-v1/;

#include "sa515m-v2.dtsi"
#include "sa515m-ccard.dtsi"

/ {
	model = "Qualcomm Technologies, Inc. SA515M CCARD V2";
	compatible = "qcom,sa515m-ccard",
			"qcom,sa515m", "qcom,ccard";
	qcom,board-id = <25 0>, <25 0x100>;
};
