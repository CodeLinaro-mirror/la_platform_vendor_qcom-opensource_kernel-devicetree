// SPDX-License-Identifier: BSD-3-Clause
/*
 * Copyright (c) Qualcomm Technologies, Inc. and/or its subsidiaries.
 */

/dts-v1/;

#include "sa8155-v1.dtsi"

/ {
	model = "Qualcomm Technologies, Inc. SA8155 SoC";
	compatible = "qcom,sa8155";
	qcom,pmic-name = "PM8150";
	qcom,board-id = <0 0>;
};
