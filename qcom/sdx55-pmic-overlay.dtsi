// SPDX-License-Identifier: BSD-3-Clause
/*
 * Copyright (c) Qualcomm Technologies, Inc. and/or its subsidiaries.
 */

#include "pmx55.dtsi"

#include <dt-bindings/pinctrl/qcom,pmic-gpio.h>


&pmx55_gpios {
	vreg_rgmii_off {
		vreg_rgmii_off_default: vreg_rgmii_off_default {
			pins = "gpio9";
			bias-pull-down;
			output-disable;
			input-enable;
		};
	};
};
