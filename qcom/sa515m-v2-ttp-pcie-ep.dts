// SPDX-License-Identifier: BSD-3-Clause
/*
 * Copyright (c) Qualcomm Technologies, Inc. and/or its subsidiaries.
 */

/dts-v1/;

#include "sa515m-v2.dtsi"

/ {
	model = "Qualcomm Technologies, Inc. SA515M TTP PCIE-EP";
	compatible = "qcom,sa515m";
	qcom,board-id = <30 1> , <30 0x101>;
};

&ethqos_hw {
	ethqos_emb_smmu: ethqos_emb_smmu {
		qcom,smmu-s1-bypass;
	};
};
