// SPDX-License-Identifier: BSD-3-Clause
/*
 * Copyright (c) Qualcomm Technologies, Inc. and/or its subsidiaries.
 */

/dts-v1/;

#include "kalama-v2.dtsi"

/ {
	model = "Qualcomm Technologies, Inc. Kalama v2 SoC";
	compatible = "qcom,kalama";
	qcom,board-id = <0 0>;
};
