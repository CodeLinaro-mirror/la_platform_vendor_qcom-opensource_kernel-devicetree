// SPDX-License-Identifier: BSD-3-Clause
/*
 * Copyright (c) Qualcomm Technologies, Inc. and/or its subsidiaries.
 */

/dts-v1/;

#include "kalamap-v2.dtsi"

/ {
	model = "Qualcomm Technologies, Inc. KalamaP v2 SoC";
	compatible = "qcom,kalamap";
	qcom,board-id = <0 0>;
};
