// SPDX-License-Identifier: BSD-3-Clause
/*
 * Copyright (c) Qualcomm Technologies, Inc. and/or its subsidiaries.
 */

/dts-v1/;

#include "cinder.dtsi"
#include "cinder-du.dtsi"
#include "cinder-du-hireg.dtsi"
#include "cinder-idp.dtsi"

/ {
	model = "Qualcomm Technologies, Inc. Cinder DU IDP";
	compatible = "qcom,cinder-idp", "qcom,cinder", "qcom,idp";
	qcom,board-id = <0x22 0x0>;
};
