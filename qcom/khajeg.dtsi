// SPDX-License-Identifier: BSD-3-Clause
/*
 * Copyright (c) Qualcomm Technologies, Inc. and/or its subsidiaries.
 */

/dts-v1/;

#include "khaje.dtsi"

/ {
	model = "Qualcomm Technologies, Inc. Khajeg SoC";
	compatible = "qcom,khajeg";
	qcom,msm-id = <585 0x10000>;
};
