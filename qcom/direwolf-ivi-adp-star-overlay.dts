// SPDX-License-Identifier: BSD-3-Clause
/*
 * Copyright (c) Qualcomm Technologies, Inc. and/or its subsidiaries.
 */

/dts-v1/;
/plugin/;

#include "direwolf-adp-star.dtsi"
#include "display/direwolf-sde-display-adp-star.dtsi"

/ {
	model = "Qualcomm Technologies, Inc. DirewolfAU IVI ADP-STAR";
	compatible = "qcom,direwolf-ivi-adp-star", "qcom,direwolf-ivi",
		"qcom,direwolf", "qcom,adp-star";
	qcom,msm-id = <460 0x10000>;
	qcom,board-id = <25 0>;
};
