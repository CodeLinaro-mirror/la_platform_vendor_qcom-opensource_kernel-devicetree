// SPDX-License-Identifier: BSD-3-Clause
/*
 * Copyright (c) Qualcomm Technologies, Inc. and/or its subsidiaries.
 */

/dts-v1/;

#include "yupikp-iot.dtsi"

/ {
	model = "Qualcomm Technologies, Inc. YUPIKP-IOT SoC";
	compatible = "qcom,yupikp-iot";
	qcom,board-id = <0 0>;
};
