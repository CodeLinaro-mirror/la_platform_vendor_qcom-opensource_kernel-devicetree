/dts-v1/;

#include "mdm9607-cdp.dtsi"
#include "mdm9206.dtsi"

/ {
	model = "Qualcomm Technologies, Inc. MDM 9206 RCM";
	compatible = "qcom,mdm9607-cdp", "qcom,mdm9607", "qcom,cdp";
	qcom,board-id = <21 0>;
};
