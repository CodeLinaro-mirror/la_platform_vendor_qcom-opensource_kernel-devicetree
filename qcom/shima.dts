// SPDX-License-Identifier: BSD-3-Clause
/*
 * Copyright (c) Qualcomm Technologies, Inc. and/or its subsidiaries.
 */

/dts-v1/;

#include "shima.dtsi"

/ {
	model = "Qualcomm Technologies, Inc. Shima SoC";
	compatible = "qcom,shima";
	qcom,board-id = <0 0>;
};
