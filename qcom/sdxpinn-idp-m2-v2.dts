// SPDX-License-Identifier: BSD-3-Clause
/*
 * Copyright (c) Qualcomm Technologies, Inc. and/or its subsidiaries.
 */

/dts-v1/;

#include "sdxpinn.dtsi"
#include "sdxpinn-idp-m2-v2.dtsi"

/ {
	model = "Qualcomm Technologies, Inc. SDXPINN IDP M2 V2";
	compatible = "qcom,sdxpinn-idp",
			"qcom,sdxpinn", "qcom,idp";
	qcom,board-id = <0x4020022 0x304>;
};
