// SPDX-License-Identifier: BSD-3-Clause
/*
 * Copyright (c) Qualcomm Technologies, Inc. and/or its subsidiaries.
 */

/dts-v1/;

#include "yupik-iot.dtsi"
#include "yupik-iot-hsp.dtsi"

/ {
	model = "Qualcomm Technologies, Inc. Yupik IoT HSP";
	compatible = "qcom,yupik-iot-idp", "qcom,yupik-iot", "qcom,idp";
	qcom,board-id = <34 1>;
};
