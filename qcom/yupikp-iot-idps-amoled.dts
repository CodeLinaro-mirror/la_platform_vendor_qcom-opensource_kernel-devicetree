// SPDX-License-Identifier: BSD-3-Clause
/*
 * Copyright (c) Qualcomm Technologies, Inc. and/or its subsidiaries.
 */

/dts-v1/;

#include "yupikp-iot.dtsi"
#include "yupikp-iot-idps-amoled.dtsi"

/ {
	model = "Qualcomm Technologies, Inc. YUPIKP-IOT IDPS + AMOLED";
	compatible = "qcom,yupikp-iot-idp", "qcom,yupikp-iot", "qcom,idp";
	qcom,board-id = <34 2>;
};
