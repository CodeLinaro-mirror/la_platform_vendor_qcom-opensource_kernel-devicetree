// SPDX-License-Identifier: BSD-3-Clause
/*
 * Copyright (c) Qualcomm Technologies, Inc. and/or its subsidiaries.
 */

/dts-v1/;
/plugin/;

#include "sa8155-adp-star.dtsi"

/ {
	model = "ADP-STAR";
	compatible = "qcom,sa8155-adp-star", "qcom,sa8155",
		"qcom,adp-star";
	qcom,msm-id = <362 0x20000>;
	qcom,board-id = <25 0>;
};
