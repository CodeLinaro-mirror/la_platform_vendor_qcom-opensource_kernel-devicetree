// SPDX-License-Identifier: BSD-3-Clause
/*
 * Copyright (c) Qualcomm Technologies, Inc. and/or its subsidiaries.
 */

/dts-v1/;

#include "kalama-vm.dtsi"
#include "kalama-vm-mtp.dtsi"

/ {
	model = "Qualcomm Technologies, Inc. Kalama SVM MTP";
	compatible = "qcom,kalama-mtp", "qcom,kalama", "qcom,mtp";
	qcom,board-id = <0x10008 0>;
};
