// SPDX-License-Identifier: BSD-3-Clause
/*
 * Copyright (c) Qualcomm Technologies, Inc. and/or its subsidiaries.
 */

/dts-v1/;
/plugin/;

#include "direwolf-vm.dtsi"
#include "direwolf-vm-lv.dtsi"

/ {
	model = "Qualcomm Technologies, Inc. Direwolf Single LV Virtual Machine";
	compatible = "qcom,direwolf", "qcom,quinvm";
	qcom,board-id = <0 0x1000002>;
};
