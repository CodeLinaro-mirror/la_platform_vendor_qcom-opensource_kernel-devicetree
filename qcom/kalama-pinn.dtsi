// SPDX-License-Identifier: BSD-3-Clause
/*
 * Copyright (c) Qualcomm Technologies, Inc. and/or its subsidiaries.
 */

&mdm0 {
	compatible = "qcom,ext-pinn";
	qcom,mdm-link-info = "0309_01.01.00";
};

&modem_pas {
	status = "disabled";
};
