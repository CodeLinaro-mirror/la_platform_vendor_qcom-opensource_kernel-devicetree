// SPDX-License-Identifier: BSD-3-Clause
/*
 * Copyright (c) Qualcomm Technologies, Inc. and/or its subsidiaries.
 */

/dts-v1/;

#include "monacop-standalone-1gb.dtsi"
#include "monaco-standalone-idp-v2.dtsi"

/ {
	model = "Qualcomm Technologies, Inc. Monaco standalone IDP V2.0";
	compatible = "qcom,monaco", "qcom,idp";
	qcom,board-id = <0x020022 0x301>;
};
