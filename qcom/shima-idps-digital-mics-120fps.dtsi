// SPDX-License-Identifier: BSD-3-Clause
/*
 * Copyright (c) Qualcomm Technologies, Inc. and/or its subsidiaries.
 */

#include "shima-idps-digital-mics.dtsi"

&soc {
};

&sde_dsi {
	qcom,dsi-default-panel = <&dsi_r66451_amoled_cmd>;
};
