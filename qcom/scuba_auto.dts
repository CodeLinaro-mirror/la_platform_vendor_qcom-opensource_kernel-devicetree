// SPDX-License-Identifier: BSD-3-Clause
/*
 * Copyright (c) Qualcomm Technologies, Inc. and/or its subsidiaries.
 */

/dts-v1/;

#include "scuba_auto.dtsi"

/ {
	model = "Qualcomm Technologies, Inc. SCUBA AUTO";
	compatible = "qcom,sa410m";
	qcom,msm-id = <441 0x10000>, <471 0x10000>;
	qcom,board-id = <0 0>;
};
