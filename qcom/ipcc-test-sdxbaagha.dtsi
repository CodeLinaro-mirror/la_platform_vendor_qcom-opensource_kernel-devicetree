// SPDX-License-Identifier: BSD-3-Clause
/*
 * Copyright (c) Qualcomm Technologies, Inc. and/or its subsidiaries.
 */

#include "ipcc-test.dtsi"

&soc {
	/delete-node/ ipcc-self-ping-adsp;
	/delete-node/ ipcc-self-ping-cdsp;
	/delete-node/ ipcc-self-ping-slpi;
};
