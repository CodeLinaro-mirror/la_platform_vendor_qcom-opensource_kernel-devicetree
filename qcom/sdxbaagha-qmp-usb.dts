// SPDX-License-Identifier: BSD-3-Clause
/*
 * Copyright (c) Qualcomm Technologies, Inc. and/or its subsidiaries.
 */

/dts-v1/;

#include "sdxbaagha.dtsi"
#include "sdxbaagha-qmp.dtsi"
#include "sdxbaagha-qmp-usb.dtsi"

/ {
	model = "Qualcomm Technologies, Inc. SDXBAAGHA QMP 256M USB";
	compatible = "qcom,sdxbaagha-qmp",
		"qcom,sdxbaagha", "qcom,qmp";
	qcom,board-id = <0x20022 0x102>;
};
