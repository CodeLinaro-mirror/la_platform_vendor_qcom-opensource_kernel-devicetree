// SPDX-License-Identifier: BSD-3-Clause
/*
 * Copyright (c) Qualcomm Technologies, Inc. and/or its subsidiaries.
 */

/dts-v1/;

#include "mdm9607-cdp.dtsi"

/ {
	model = "Qualcomm Technologies, Inc. MDM 9607 CDP";
	compatible = "qcom,mdm9607-cdp", "qcom,mdm9607", "qcom,cdp";
	qcom,board-id = <1 0>;
};
