// SPDX-License-Identifier: BSD-3-Clause
/*
 * Copyright (c) Qualcomm Technologies, Inc. and/or its subsidiaries.
 */

/dts-v1/;

#include "sdxnightjar.dtsi"
#include "sdxnightjar-qrd.dtsi"

/ {
	model = "Qualcomm Technologies, Inc. SDX NIGHTJAR QRD";
	compatible = "qcom,sdxnightjar-qrd",
		   "qcom,sdxnightjar", "qcom,qrd";
	qcom,board-id = <0xB 0>;
};
