// SPDX-License-Identifier: BSD-3-Clause
/*
 * Copyright (c) Qualcomm Technologies, Inc. and/or its subsidiaries.
 */

/dts-v1/;

#include "monaco-standalone-1gb.dtsi"
#include "monaco-standalone-wdp-v1.dtsi"

/ {
	model = "Qualcomm Technologies, Inc. Monaco standalone WDP V1.0";
	compatible = "qcom,monaco", "qcom,wdp";
	qcom,board-id = <0x010024 0x301>;
};
