// SPDX-License-Identifier: BSD-3-Clause
/*
 * Copyright (c) Qualcomm Technologies, Inc. and/or its subsidiaries.
 */

#include "cinder-v2.dtsi"
#include "cinder-du.dtsi"

/ {
	model = "Qualcomm Technologies, Inc. Cinder V2 DU";
	compatible = "qcom,cinder";
	qcom,msm-id = <545 0x20000>, <587 0x20000>;
};
