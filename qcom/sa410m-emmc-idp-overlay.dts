// SPDX-License-Identifier: BSD-3-Clause
/*
 * Copyright (c) Qualcomm Technologies, Inc. and/or its subsidiaries.
 */

/dts-v1/;
/plugin/;

#include "sa410m-emmc.dtsi"

/ {
	model = "Qualcomm Technologies, Inc. SA410M EMMC IDP";
	compatible = "qcom,sa410m", "qcom,idp", "qcom,sa410m-idp";
	qcom,msm-id=<560 0x10000>;
	qcom,board-id = <34 0x300>;
};
