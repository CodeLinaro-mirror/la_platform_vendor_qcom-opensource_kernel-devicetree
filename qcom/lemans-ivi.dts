// SPDX-License-Identifier: BSD-3-Clause
/*
 * Copyright (c) Qualcomm Technologies, Inc. and/or its subsidiaries.
 */

/dts-v1/;

#include "lemans-ivi.dtsi"
/ {
	model = "Qualcomm Technologies, Inc. Lemans IVI SoC";
	compatible = "qcom,lemans-ivi", "qcom,lemans";
	qcom,board-id = <0 0>;
};
