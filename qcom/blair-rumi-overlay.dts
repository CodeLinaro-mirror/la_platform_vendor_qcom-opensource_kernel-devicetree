// SPDX-License-Identifier: BSD-3-Clause
/*
 * Copyright (c) Qualcomm Technologies, Inc. and/or its subsidiaries.
 */

/dts-v1/;
/plugin/;

#include "blair-rumi.dtsi"

/ {
	model = "Qualcomm Technologies, Inc. Blair RUMI";
	compatible = "qcom,blair-rumi", "qcom,blair", "qcom,rumi";
	qcom,msm-id = <507 0x10000>, <578 0x10000>;
	qcom,board-id = <15 0>;
};
