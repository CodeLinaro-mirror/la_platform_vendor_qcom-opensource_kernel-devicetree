// SPDX-License-Identifier: BSD-3-Clause
/*
 * Copyright (c) Qualcomm Technologies, Inc. and/or its subsidiaries.
 */

/dts-v1/;

#include "shima.dtsi"
#include "shima-qrd.dtsi"

/ {
	model = "Qualcomm Technologies, Inc. Shima QRD";
	compatible = "qcom,shima-qrd", "qcom,shima", "qcom,qrd";
	qcom,board-id = <0x1000B 0>;
};
