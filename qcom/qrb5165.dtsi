// SPDX-License-Identifier: BSD-3-Clause
/*
 * Copyright (c) Qualcomm Technologies, Inc. and/or its subsidiaries.
 */


#include "kona-v2.dtsi"

/ {
	model = "Qualcomm Technologies, Inc. qrb5165";
	compatible = "qcom,kona";
	qcom,msm-id = <455 0x20001>;
};

#include "kona-v2.1-gpu.dtsi"

