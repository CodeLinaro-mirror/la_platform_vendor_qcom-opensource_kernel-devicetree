// SPDX-License-Identifier: BSD-3-Clause
/*
 * Copyright (c) Qualcomm Technologies, Inc. and/or its subsidiaries.
 */

/dts-v1/;

#include "shima-vm.dtsi"
#include "shima-vm-idp.dtsi"

/ {
	model = "Qualcomm Technologies, Inc. Shima VM IDP";
	compatible = "qcom,shima-idp", "qcom,shima", "qcom,idp";
	qcom,board-id = <34 0>;
};
