// SPDX-License-Identifier: BSD-3-Clause
/*
 * Copyright (c) Qualcomm Technologies, Inc. and/or its subsidiaries.
 */

/dts-v1/;

#include "kalamap-sg.dtsi"

/ {
	model = "Qualcomm Technologies, Inc. KalamaP SG SoC";
	compatible = "qcom,kalamap";
	qcom,board-id = <0 0>;
};
