// SPDX-License-Identifier: BSD-3-Clause
/*
 * Copyright (c) Qualcomm Technologies, Inc. and/or its subsidiaries.
 */

#include "sdxpinn-idp-cpe.dtsi"

&soc {
};

&wifi0 {
	 board_id = <0x1010>;
};

&wifi2 {
	status = "disabled";
};
