// SPDX-License-Identifier: BSD-3-Clause
/*
 * Copyright (c) Qualcomm Technologies, Inc. and/or its subsidiaries.
 */

#include "kona-v2.1-iot-rb5.dtsi"
#include "camera/kona-camera-sensor-rb5-m.dtsi"
