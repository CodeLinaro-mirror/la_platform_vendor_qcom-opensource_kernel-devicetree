// SPDX-License-Identifier: BSD-3-Clause
/*
 * Copyright (c) Qualcomm Technologies, Inc. and/or its subsidiaries.
 */

/ {
	qcom,msm-id = <322 0x10000>;
};

&modem_adsp_mem {
	reg = <0x82a00000 0x2a00000>;
};

&cnss_debug_mem {
	status = "disabled";
};
