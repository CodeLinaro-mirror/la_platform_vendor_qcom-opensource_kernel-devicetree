// SPDX-License-Identifier: BSD-3-Clause
/*
 * Copyright (c) Qualcomm Technologies, Inc. and/or its subsidiaries.
 */

/dts-v1/;

#include "sdxlemur-v2.dtsi"
#include "sdxlemur-cdp.dtsi"
#include "sdxlemur-1024mb.dtsi"
#include "sdxlemur-audio.dtsi"
#include "sdxlemur-cdp-audio-overlay.dtsi"

/ {
	model = "Qualcomm Technologies, Inc. SDXLEMUR CDP V2";
	compatible = "qcom,sdxlemur-cdp",
		"qcom,sdxlemur", "qcom,cdp";
	qcom,board-id = <0x20001 0x300>;
};
