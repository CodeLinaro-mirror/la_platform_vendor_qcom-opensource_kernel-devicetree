/dts-v1/;

#include "sdxbaagha-128m.dtsi"
#include "sdxbaagha-128m-idp.dtsi"

/ {
	model = "Qualcomm Technologies, Inc. SDXBAAGHA IDP 128M";
	compatible = "qcom,sdxbaagha-idp",
		"qcom,sdxbaagha", "qcom,idp";
	qcom,board-id = <0x10022 0x703>, <0x10022 0x103>, <0x10022 0x203>;
};
