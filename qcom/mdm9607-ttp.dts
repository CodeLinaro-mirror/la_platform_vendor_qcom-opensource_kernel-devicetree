// SPDX-License-Identifier: BSD-3-Clause
/*
 * Copyright (c) Qualcomm Technologies, Inc. and/or its subsidiaries.
 */

/dts-v1/;

#include "mdm9607-mtp.dtsi"
/ {
	model = "Qualcomm Technologies, Inc. MDM 9607 TTP";
	compatible = "qcom,mdm9607-ttp", "qcom,mdm9607", "qcom,ttp";
	qcom,board-id = <0x1E 0>;
};
