// SPDX-License-Identifier: BSD-3-Clause
/*
 * Copyright (c) Qualcomm Technologies, Inc. and/or its subsidiaries.
 */

/dts-v1/;

#include "qrb5165.dtsi"
#include "qrb5165m-pine.dtsi"

/ {
	model = "Qualcomm Technologies, Inc. QRB5165M IOT RB5 PINE";
	compatible = "qcom,kona-iot", "qcom,kona", "qcom,iot";
	qcom,board-id = <0x04010B 0x03>;
};
