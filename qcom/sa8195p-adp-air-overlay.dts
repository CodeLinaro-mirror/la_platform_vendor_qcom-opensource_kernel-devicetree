// SPDX-License-Identifier: BSD-3-Clause
/*
 * Copyright (c) Qualcomm Technologies, Inc. and/or its subsidiaries.
 */

/dts-v1/;
/plugin/;

#include "sa8195p-adp-air.dtsi"

/ {
	model = "SA8195P ADP-AIR";
	compatible = "qcom,sa8195p-adp-air", "qcom,sa8195p",
		"qcom,adp-air";
	qcom,msm-id = <405 0x20000>;
	qcom,board-id = <0x02010019 0>;
};
