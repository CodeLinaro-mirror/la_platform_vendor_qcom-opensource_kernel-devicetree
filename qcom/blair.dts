// SPDX-License-Identifier: BSD-3-Clause
/*
 * Copyright (c) Qualcomm Technologies, Inc. and/or its subsidiaries.
 */

/dts-v1/;

#include "blair.dtsi"

/ {
	model = "Qualcomm Technologies, Inc. Blair SoC";
	compatible = "qcom,blair";
	qcom,board-id = <0 0>;
};
