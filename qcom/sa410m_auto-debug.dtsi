// SPDX-License-Identifier: BSD-3-Clause
/*
 * Copyright (c) Qualcomm Technologies, Inc. and/or its subsidiaries.
 */

#include <dt-bindings/soc/qcom,dcc_v2.h>

&soc {
	dcc: dcc_v2@1be2000 {
		compatible = "qcom,dcc-v2";
		reg = <0x1be2000 0x1000>,
			<0x1bee000 0x2000>;
		reg-names = "dcc-base", "dcc-ram-base";
		dcc-ram-offset = <0x2000>;

		link_list1 {
			qcom,curr-link-list = <3>;
			qcom,data-sink = "sram";
			qcom,link-list = <DCC_READ 0x0f1880b4 1 0>,
				<DCC_READ 0x0f1980b4 1 0>,
				<DCC_READ 0x0f1a80b4 1 0>,
				<DCC_READ 0x0f1b80b4 1 0>,
				<DCC_READ 0x0f1d1228 1 0>,
				<DCC_READ 0x4488100 1 0>,
				<DCC_READ 0x4488400 2 0>,
				<DCC_READ 0x4488410 1 0>,
				<DCC_READ 0x4488420 2 0>,
				<DCC_READ 0x4488430 2 0>,
				<DCC_READ 0x448c100 1 0>,
				<DCC_READ 0x448c400 2 0>,
				<DCC_READ 0x448c410 1 0>,
				<DCC_READ 0x448c420 2 0>,
				<DCC_READ 0x448c430 2 0>,
				<DCC_READ 0x4490100 1 0>,
				<DCC_READ 0x4490400 2 0>,
				<DCC_READ 0x4490410 1 0>,
				<DCC_READ 0x4490420 2 0>,
				<DCC_READ 0x4490430 2 0>,
				<DCC_READ 0x4494100 1 0>,
				<DCC_READ 0x4494400 2 0>,
				<DCC_READ 0x4494410 1 0>,
				<DCC_READ 0x4494420 2 0>,
				<DCC_READ 0x4494430 2 0>,
				<DCC_READ 0x449810c 1 0>,
				<DCC_READ 0x4498400 2 0>,
				<DCC_READ 0x4498410 1 0>,
				<DCC_READ 0x4498420 2 0>,
				<DCC_READ 0x4498430 2 0>,
				<DCC_READ 0x44a0100 1 0>,
				<DCC_READ 0x44a0400 2 0>,
				<DCC_READ 0x44a0410 1 0>,
				<DCC_READ 0x44a0420 2 0>,
				<DCC_READ 0x44a0430 2 0>,
				<DCC_READ 0x44b0560 1 0>,
				<DCC_READ 0x44b05a0 1 0>,
				<DCC_READ 0x44b1800 1 0>,
				<DCC_READ 0x44b408c 1 0>,
				<DCC_READ 0x44b409c 1 0>,
				<DCC_READ 0x44b0520 1 0>,
				<DCC_READ 0x44b5070 2 0>,
				<DCC_READ 0x44bd800 1 0>,
				<DCC_READ 0x4480040 2 0>,
				<DCC_READ 0x4480810 2 0>,
				<DCC_READ 0x44b0a40 1 0>,
				<DCC_READ 0x4506044 1 0>,
				<DCC_READ 0x45061dc 1 0>,
				<DCC_READ 0x45061ec 1 0>,
				<DCC_READ 0x4506028 2 0>,
				<DCC_READ 0x4506094 1 0>,
				<DCC_READ 0x4506608 1 0>,
				<DCC_READ 0x447d02c 4 0>,
				<DCC_READ 0x447d040 1 0>,
				<DCC_READ 0x450002c 2 0>,
				<DCC_READ 0x4500094 1 0>,
				<DCC_READ 0x450009c 1 0>,
				<DCC_READ 0x45000c4 2 0>,
				<DCC_READ 0x45003dc 1 0>,
				<DCC_READ 0x45005d8 1 0>,
				<DCC_READ 0x450202c 2 0>,
				<DCC_READ 0x4502094 1 0>,
				<DCC_READ 0x450209c 1 0>,
				<DCC_READ 0x45020c4 2 0>,
				<DCC_READ 0x45023dc 1 0>,
				<DCC_READ 0x45025d8 1 0>,
				<DCC_READ 0x450302c 2 0>,
				<DCC_READ 0x4503094 1 0>,
				<DCC_READ 0x450309c 1 0>,
				<DCC_READ 0x45030c4 2 0>,
				<DCC_READ 0x45033dc 1 0>,
				<DCC_READ 0x45035d8 1 0>,
				<DCC_READ 0x1900010 1 0>,
				<DCC_READ 0x1900020 1 0>,
				<DCC_READ 0x1900024 1 0>,
				<DCC_READ 0x1900028 1 0>,
				<DCC_READ 0x190002c 1 0>,
				<DCC_READ 0x1900030 1 0>,
				<DCC_READ 0x1900034 1 0>,
				<DCC_READ 0x1900038 1 0>,
				<DCC_READ 0x190003c 1 0>,
				<DCC_READ 0x1900240 1 0>,
				<DCC_READ 0x1900244 1 0>,
				<DCC_READ 0x1900248 1 0>,
				<DCC_READ 0x190024c 1 0>,
				<DCC_READ 0x1900250 1 0>,
				<DCC_READ 0x1900258 1 0>,
				<DCC_READ 0x1900290 1 0>,
				<DCC_READ 0x1900300 1 0>,
				<DCC_READ 0x1900304 1 0>,
				<DCC_READ 0x1900308 1 0>,
				<DCC_READ 0x190030c 1 0>,
				<DCC_READ 0x1900310 1 0>,
				<DCC_READ 0x1900314 1 0>,
				<DCC_READ 0x1900318 1 0>,
				<DCC_READ 0x1900900 1 0>,
				<DCC_READ 0x1900904 1 0>,
				<DCC_READ 0x1900d00 1 0>,
				<DCC_READ 0x1909100 1 0>,
				<DCC_READ 0x1909104 1 0>,
				<DCC_READ 0x44b0120 1 0>,
				<DCC_READ 0x44b0124 1 0>,
				<DCC_READ 0x44b0128 1 0>,
				<DCC_READ 0x44b012c 1 0>,
				<DCC_READ 0x44b0130 1 0>,
				<DCC_READ 0x44b0100 1 0>,
				<DCC_READ 0x44b0020 1 0>,
				<DCC_READ 0x1411004 1 0>,
				<DCC_READ 0x1411028 1 0>,
				<DCC_READ 0x1458004 1 0>,
				<DCC_READ 0x1880108 1 0>,
				<DCC_READ 0x1880110 1 0>,
				<DCC_READ 0x1880120 1 0>,
				<DCC_READ 0x1880124 1 0>,
				<DCC_READ 0x1880128 1 0>,
				<DCC_READ 0x188012c 1 0>,
				<DCC_READ 0x1880130 1 0>,
				<DCC_READ 0x1880134 1 0>,
				<DCC_READ 0x1880138 1 0>,
				<DCC_READ 0x188013c 1 0>,
				<DCC_READ 0x1880240 1 0>,
				<DCC_READ 0x1880248 1 0>,
				<DCC_READ 0x1880290 1 0>,
				<DCC_READ 0x1880300 1 0>,
				<DCC_READ 0x1880304 1 0>,
				<DCC_READ 0x1880308 1 0>,
				<DCC_READ 0x188030c 1 0>,
				<DCC_READ 0x1880310 1 0>,
				<DCC_READ 0x1880314 1 0>,
				<DCC_READ 0x1880318 1 0>,
				<DCC_READ 0x188031c 1 0>,
				<DCC_READ 0x1880700 1 0>,
				<DCC_READ 0x1880704 1 0>,
				<DCC_READ 0x1880708 1 0>,
				<DCC_READ 0x188070c 1 0>,
				<DCC_READ 0x1880710 1 0>,
				<DCC_READ 0x1880714 1 0>,
				<DCC_READ 0x1880718 1 0>,
				<DCC_READ 0x188071c 1 0>,
				<DCC_READ 0x1881100 1 0>,
				<DCC_READ 0x1881104 1 0>,
				<DCC_READ 0xf112000 1 0>,
				<DCC_READ 0xf11200c 1 0>,
				<DCC_READ 0xf112c0c 1 0>,
				<DCC_READ 0xf112c10 1 0>,
				<DCC_READ 0xf112c20 1 0>,
				<DCC_READ 0xf1b9000 1 0>,
				<DCC_READ 0xf1b900c 1 0>,
				<DCC_READ 0xf1b9c0c 1 0>,
				<DCC_READ 0xf1b9c10 1 0>,
				<DCC_READ 0xf1b9c18 1 0>,
				<DCC_READ 0xf1a9000 1 0>,
				<DCC_READ 0xf1a900c 1 0>,
				<DCC_READ 0xf1a9c0c 1 0>,
				<DCC_READ 0xf1a9c10 1 0>,
				<DCC_READ 0xf1a9c20 1 0>,
				<DCC_READ 0xf199000 1 0>,
				<DCC_READ 0xf19900c 1 0>,
				<DCC_READ 0xf199c0c 1 0>,
				<DCC_READ 0xf199c10 1 0>,
				<DCC_READ 0xf199c20 1 0>,
				<DCC_READ 0xf189000 1 0>,
				<DCC_READ 0xf18900c 1 0>,
				<DCC_READ 0xf189c0c 1 0>,
				<DCC_READ 0xf189c10 1 0>,
				<DCC_READ 0xf189c20 1 0>,
				<DCC_READ 0xf111014 1 0>,
				<DCC_READ 0xf111018 1 0>,
				<DCC_READ 0xf111218 1 0>,
				<DCC_READ 0xf111234 1 0>,
				<DCC_READ 0xf111264 1 0>,
				<DCC_READ 0xf111290 1 0>,
				<DCC_READ 0x0f521700 1 0>,
				<DCC_READ 0x0f112c18 1 0>,
				<DCC_READ 0x0f513a84 1 0>,
				<DCC_READ 0x01b60110 1 0>,
				<DCC_READ 0x1400000 1 0>,
				<DCC_READ 0x1400004 1 0>,
				<DCC_READ 0x1400008 1 0>,
				<DCC_READ 0x1400010 1 0>,
				<DCC_READ 0x1400014 1 0>,
				<DCC_READ 0x1400018 1 0>,
				<DCC_READ 0x1400020 1 0>,
				<DCC_READ 0x1400024 1 0>,
				<DCC_READ 0x1401000 1 0>,
				<DCC_READ 0x1401004 1 0>,
				<DCC_READ 0x1401008 1 0>,
				<DCC_READ 0x1401010 1 0>,
				<DCC_READ 0x1401014 1 0>,
				<DCC_READ 0x1401018 1 0>,
				<DCC_READ 0x1401020 1 0>,
				<DCC_READ 0x1401024 1 0>,
				<DCC_READ 0x1402000 1 0>,
				<DCC_READ 0x1402004 1 0>,
				<DCC_READ 0x1402008 1 0>,
				<DCC_READ 0x1402010 1 0>,
				<DCC_READ 0x1402014 1 0>,
				<DCC_READ 0x1402018 1 0>,
				<DCC_READ 0x1402020 1 0>,
				<DCC_READ 0x1402024 1 0>,
				<DCC_READ 0x1403000 1 0>,
				<DCC_READ 0x1403004 1 0>,
				<DCC_READ 0x1403008 1 0>,
				<DCC_READ 0x1403010 1 0>,
				<DCC_READ 0x1403014 1 0>,
				<DCC_READ 0x1403018 1 0>,
				<DCC_READ 0x1403020 1 0>,
				<DCC_READ 0x1403024 1 0>,
				<DCC_READ 0x1404000 1 0>,
				<DCC_READ 0x1404004 1 0>,
				<DCC_READ 0x1404008 1 0>,
				<DCC_READ 0x1404010 1 0>,
				<DCC_READ 0x1404014 1 0>,
				<DCC_READ 0x1404018 1 0>,
				<DCC_READ 0x1404020 1 0>,
				<DCC_READ 0x1404024 1 0>,
				<DCC_READ 0x1405000 1 0>,
				<DCC_READ 0x1405004 1 0>,
				<DCC_READ 0x1405008 1 0>,
				<DCC_READ 0x1405010 1 0>,
				<DCC_READ 0x1405014 1 0>,
				<DCC_READ 0x1405018 1 0>,
				<DCC_READ 0x1405020 1 0>,
				<DCC_READ 0x1405024 1 0>,
				<DCC_READ 0x1406000 1 0>,
				<DCC_READ 0x1406004 1 0>,
				<DCC_READ 0x1406008 1 0>,
				<DCC_READ 0x1406010 1 0>,
				<DCC_READ 0x1406014 1 0>,
				<DCC_READ 0x1406018 1 0>,
				<DCC_READ 0x1406020 1 0>,
				<DCC_READ 0x1406024 1 0>,
				<DCC_READ 0x1407000 1 0>,
				<DCC_READ 0x1407004 1 0>,
				<DCC_READ 0x1407008 1 0>,
				<DCC_READ 0x1407010 1 0>,
				<DCC_READ 0x1407014 1 0>,
				<DCC_READ 0x1407018 1 0>,
				<DCC_READ 0x1407020 1 0>,
				<DCC_READ 0x1407024 1 0>,
				<DCC_READ 0x1407028 1 0>,
				<DCC_READ 0x1408000 1 0>,
				<DCC_READ 0x1408004 1 0>,
				<DCC_READ 0x1408008 1 0>,
				<DCC_READ 0x1408010 1 0>,
				<DCC_READ 0x1408014 1 0>,
				<DCC_READ 0x1408018 1 0>,
				<DCC_READ 0x1408020 1 0>,
				<DCC_READ 0x1408024 1 0>,
				<DCC_READ 0x1409000 1 0>,
				<DCC_READ 0x1409004 1 0>,
				<DCC_READ 0x1409008 1 0>,
				<DCC_READ 0x1409010 1 0>,
				<DCC_READ 0x1409014 1 0>,
				<DCC_READ 0x1409018 1 0>,
				<DCC_READ 0x1409020 1 0>,
				<DCC_READ 0x1414024 1 0>,
				<DCC_READ 0x1416038 1 0>,
				<DCC_READ 0x1415034 1 0>,
				<DCC_READ 0x1417040 1 0>,
				<DCC_READ 0x1420010 1 0>,
				<DCC_READ 0x1420014 1 0>,
				<DCC_READ 0x1426018 1 0>,
				<DCC_READ 0x1426030 1 0>,
				<DCC_READ 0x1426034 1 0>,
				<DCC_READ 0x1427024 1 0>,
				<DCC_READ 0x1428014 1 0>,
				<DCC_READ 0x1428018 1 0>,
				<DCC_READ 0x1428030 1 0>,
				<DCC_READ 0x1429004 1 0>,
				<DCC_READ 0x1429008 1 0>,
				<DCC_READ 0x1429040 1 0>,
				<DCC_READ 0x1429044 1 0>,
				<DCC_READ 0x1446004 1 0>,
				<DCC_READ 0x1446008 1 0>,
				<DCC_READ 0x1446024 1 0>,
				<DCC_READ 0x1446150 1 0>,
				<DCC_READ 0x1442018 1 0>,
				<DCC_READ 0x1442030 1 0>,
				<DCC_READ 0x1442034 1 0>,
				<DCC_READ 0x1432034 1 0>,
				<DCC_READ 0x1438010 1 0>,
				<DCC_READ 0x1438014 1 0>,
				<DCC_READ 0x1438028 1 0>,
				<DCC_READ 0x1445004 1 0>,
				<DCC_READ 0x1445020 1 0>,
				<DCC_READ 0x1451000 1 0>,
				<DCC_READ 0x1451004 1 0>,
				<DCC_READ 0x1451020 1 0>,
				<DCC_READ 0x1451038 1 0>,
				<DCC_READ 0x1451054 1 0>,
				<DCC_READ 0x1451058 1 0>,
				<DCC_READ 0x1452004 1 0>,
				<DCC_READ 0x1452008 1 0>,
				<DCC_READ 0x1452028 1 0>,
				<DCC_READ 0x1455000 1 0>,
				<DCC_READ 0x1455004 1 0>,
				<DCC_READ 0x1448024 1 0>,
				<DCC_READ 0x1475000 1 0>,
				<DCC_READ 0x1475004 1 0>,
				<DCC_READ 0x1477000 1 0>,
				<DCC_READ 0x1477004 1 0>,
				<DCC_READ 0x1479000 1 0>,
				<DCC_READ 0x1479004 1 0>,
				<DCC_READ 0x1457000 1 0>,
				<DCC_READ 0x1457004 1 0>,
				<DCC_READ 0x1457008 1 0>,
				<DCC_READ 0x1457010 1 0>,
				<DCC_READ 0x1469000 1 0>,
				<DCC_READ 0x1469004 1 0>,
				<DCC_READ 0x1469008 1 0>,
				<DCC_READ 0x1469010 1 0>,
				<DCC_READ 0x1495000 1 0>,
				<DCC_READ 0x1495004 1 0>,
				<DCC_READ 0x1463020 1 0>,
				<DCC_READ 0x1478030 1 0>,
				<DCC_READ 0x1490004 1 0>,
				<DCC_READ 0x1490008 1 0>,
				<DCC_READ 0x1490024 1 0>,
				<DCC_READ 0x1490028 1 0>,
				<DCC_READ 0x1407030 1 0>,
				<DCC_READ 0x1407034 1 0>,
				<DCC_READ 0x1432080 1 0>,
				<DCC_READ 0xf017000 1 0>,
				<DCC_READ 0xf01700c 1 0>,
				<DCC_READ 0xf017010 1 0>,
				<DCC_READ 0xf017014 1 0>,
				<DCC_READ 0xf017018 1 0>,
				<DCC_READ 0xf017020 1 0>,
				<DCC_READ 0x1414008 1 0>,
				<DCC_READ 0x1414004 1 0>,
				<DCC_READ 0x440b00c 1 0>,
				<DCC_READ 0x440b014 1 0>,
				<DCC_READ 0x0f522c14 1 0>,
				<DCC_READ 0x0f522c1c 1 0>,
				<DCC_READ 0x0f522c10 1 0>,
				<DCC_READ 0x0f521920 1 0>,
				<DCC_READ 0x0f52102c 1 0>,
				<DCC_READ 0x0f521044 1 0>,
				<DCC_READ 0x0f521710 1 0>,
				<DCC_READ 0x0f52176c 1 0>,
				<DCC_READ 0x0f116000 1 0>,
				<DCC_READ 0x0f116004 1 0>,
				<DCC_READ 0x0f11602c 1 0>,
				<DCC_READ 0x0f111250 1 0>,
				<DCC_READ 0x0f111254 1 0>,
				<DCC_READ 0x0f111258 1 0>,
				<DCC_READ 0x0f11125c 1 0>,
				<DCC_READ 0x0f111260 1 0>,
				<DCC_READ 0x0f188078 1 0>,
				<DCC_READ 0x0f188084 1 0>,
				<DCC_READ 0x0f198078 1 0>,
				<DCC_READ 0x0f198084 1 0>,
				<DCC_READ 0x0f1a8078 1 0>,
				<DCC_READ 0x0f1a8084 1 0>,
				<DCC_READ 0x0f1b8078 1 0>,
				<DCC_READ 0x0f1b8084 1 0>,
				<DCC_READ 0x0f521818 1 0>,
				<DCC_READ 0x0f52181c 1 0>,
				<DCC_READ 0x0f521828 1 0>,
				<DCC_READ 0x0f522c18 1 0>,
				<DCC_READ 0x0f111310 1 0>,
				<DCC_READ 0x0f111314 1 0>,
				<DCC_READ 0x0f111318 1 0>,
				<DCC_WRITE 0x9870010 0x14000 1>,
				<DCC_WRITE 0x9870010 0x0 1>;
		};
	};
};
