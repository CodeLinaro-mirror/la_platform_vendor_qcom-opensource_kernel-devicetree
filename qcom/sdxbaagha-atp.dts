// SPDX-License-Identifier: BSD-3-Clause
/*
 * Copyright (c) Qualcomm Technologies, Inc. and/or its subsidiaries.
 */

/dts-v1/;

#include "sdxbaagha.dtsi"
#include "sdxbaagha-atp.dtsi"

/ {
	model = "Qualcomm Technologies, Inc. SDXBAAGHA ATP 256M";
	compatible = "qcom,sdxbaagha-atp",
		"qcom,sdxbaagha", "qcom,atp";
	qcom,board-id = <0x10021 0x100>, <0x10021 0x200>;
};
