// SPDX-License-Identifier: BSD-3-Clause
/*
 * Copyright (c) Qualcomm Technologies, Inc. and/or its subsidiaries.
 */

/dts-v1/;

#include "sa525m-televm.dtsi"

/ {
	model = "Qualcomm Technologies, Inc. SA525M TELEVM";
	compatible = "qcom,sa525m","qcom,sdxpinn", "qcom,sa525m-televm";
	qcom,board-id = <0 0>;
};
