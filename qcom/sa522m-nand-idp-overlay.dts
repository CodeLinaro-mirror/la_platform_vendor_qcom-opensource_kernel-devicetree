/dts-v1/;
/plugin/;

#include "sa525m-idp.dtsi"
#include "sa525m-dsmharq-38m.dtsi"

/ {
	model = "Qualcomm Technologies, Inc. SA522 NAND IDP Overlay";
	compatible = "qcom,sdxpinn-idp",
		"qcom,sdxpinn", "qcom,idp";
	qcom,msm-id=<559 0x10000>;
	qcom,board-id = <0x0010022 0x20000>;
};
